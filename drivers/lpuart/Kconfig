## drivers/spc/Kconfig
```kconfig
# Copyright 2024 NXP
#
# SPDX-License-Identifier: BSD-3-Clause

config MCUX_HAS_COMPONENT_driver.spc
    bool
    default y if MCUX_HW_IP_DriverType_SPC

config MCUX_COMPONENT_driver.spc
    bool "spc"
    select MCUX_COMPONENT_driver.common
    depends on MCUX_HAS_COMPONENT_driver.spc

if MCUX_COMPONENT_driver.spc

    config SPC_BUSY_TIMEOUT
        int "Max loops to wait for SPC to stop being busy (0 means wait forever)"
        default 0
        help
          The BUSY bitfield will be set when the SPC performs any kind of power mode
          transition in active mode or any chip low power mode. You need to wait until
          this flag is cleared before changing the power mode configuration registers.
          This parameter defines how many loops to check completion before return timeout.
          If defined as 0, the driver will wait until completion.

    config SPC_SRAM_ACK_TIMEOUT
        int "Max loops to wait for SRAM voltage update request acknowledge (0 means wait forever)"
        default 0
        help
          When changing SRAM voltage, need to wait for SRAM voltage update request acknowledgment.
          This parameter defines how many loops to check completion before return timeout.
          If defined as 0, the driver will wait until completion.

    config SPC_DCDC_ACK_TIMEOUT
        int "Max loops to wait for DCDC burst completed (0 means wait forever)"
        default 0
        help
          When the DCDC burst is requested, it is necessary to wait for the DCDC burst to complete.
          This parameter defines how many loops to check completion before return timeout.
          If defined as 0, the driver will wait until it completes.

endif
```

## drivers/spdif/Kconfig
```kconfig
# Copyright 2024 NXP
#
# SPDX-License-Identifier: BSD-3-Clause

config MCUX_HAS_COMPONENT_driver.spdif
    bool
    default y if MCUX_HW_IP_DriverType_SPDIF

config MCUX_COMPONENT_driver.spdif_edma
    bool "Use driver spdif_edma"
    select MCUX_COMPONENT_driver.spdif

config MCUX_COMPONENT_driver.spdif
    bool "Use driver spdif"
    select MCUX_COMPONENT_driver.common
    depends on MCUX_HAS_COMPONENT_driver.spdif
```

## drivers/sramc/Kconfig
```kconfig
# Copyright 2025 NXP
#
# SPDX-License-Identifier: BSD-3-Clause

config MCUX_HAS_COMPONENT_driver.sramc
    bool
    default y if MCUX_HW_IP_DriverType_SRAMC

config MCUX_COMPONENT_driver.sramc
    bool "sramc"
    select MCUX_COMPONENT_driver.common
    depends on MCUX_HAS_COMPONENT_driver.sramc
```

## drivers/sramc_1/Kconfig
```kconfig
# Copyright 2025 NXP
#
# SPDX-License-Identifier: BSD-3-Clause

config MCUX_HAS_COMPONENT_driver.sramc_1
    bool
    default y if MCUX_HW_IP_DriverType_SRAMC_1

config MCUX_COMPONENT_driver.sramc_1
    bool "sramc_1"
    select MCUX_COMPONENT_driver.common
    depends on MCUX_HAS_COMPONENT_driver.sramc_1
```
