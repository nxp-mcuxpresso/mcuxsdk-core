## drivers/powerquad/Kconfig
```kconfig
# Copyright 2024 NXP
#
# SPDX-License-Identifier: BSD-3-Clause

config MCUX_HAS_COMPONENT_driver.powerquad
    bool
    default y if MCUX_HW_IP_DriverType_POWERQUAD || MCUX_HW_IP_DriverType_LPC_POWERQUAD

config MCUX_HAS_COMPONENT_driver.powerquad_cmsis
    bool
    default y if MCUX_HW_IP_DriverType_LPC_POWERQUAD || MCUX_HW_IP_DriverType_POWERQUAD

config MCUX_COMPONENT_driver.powerquad
    bool "powerquad"
    select MCUX_COMPONENT_driver.common
    depends on MCUX_HAS_COMPONENT_driver.powerquad

config MCUX_COMPONENT_driver.powerquad_cmsis
    bool "powerquad_cmsis"
    select MCUX_COMPONENT_driver.powerquad
    select MCUX_COMPONENT_CMSIS_DSP_Include
    depends on MCUX_HAS_COMPONENT_driver.powerquad_cmsis

if MCUX_COMPONENT_driver.powerquad_cmsis

    menu "Use PowerQuad CMSIS DSP API with prefix pq_"

    config PQ_ARM_COS_F32
        bool "pq_arm_cos_f32"
        help
          Use API name pq_arm_cos_f32 instead of arm_cos_f32

    config PQ_ARM_COS_Q31
        bool "pq_arm_cos_q31"
        help
          Use API name pq_arm_cos_q31 instead of arm_cos_q31

    config PQ_ARM_COS_Q15
        bool "pq_arm_cos_q15"
        help
          Use API name pq_arm_cos_q15 instead of arm_cos_q15

    config PQ_ARM_SIN_F32
        bool "pq_arm_sin_f32"
        help
          Use API name pq_arm_sin_f32 instead of arm_sin_f32

    config PQ_ARM_SIN_Q31
        bool "pq_arm_sin_q31"
        help
          Use API name pq_arm_sin_q31 instead of arm_sin_q31

    config PQ_ARM_SIN_Q15
        bool "pq_arm_sin_q15"
        help
          Use API name pq_arm_sin_q15 instead of arm_sin_q15

    config PQ_ARM_SQRT_Q31
        bool "pq_arm_sqrt_q31"
        help
          Use API name pq_arm_sqrt_q31 instead of arm_sqrt_q31

    config PQ_ARM_SQRT_Q15
        bool "pq_arm_sqrt_q15"
        help
          Use API name pq_arm_sqrt_q15 instead of arm_sqrt_q15

    config PQ_ARM_CFFT_Q31
        bool "pq_arm_cfft_q31"
        help
          Use API name pq_arm_cfft_q31 instead of arm_cfft_q31

    config PQ_ARM_CFFT_Q15
        bool "pq_arm_cfft_q15"
        help
          Use API name pq_arm_cfft_q15 instead of arm_cfft_q15

    config PQ_ARM_RFFT_INIT_Q31
        bool "pq_arm_rfft_init_q31"
        help
          Use API name pq_arm_rfft_init_q31 instead of arm_rfft_init_q31

    config PQ_ARM_RFFT_Q31
        bool "pq_arm_rfft_q31"
        help
          Use API name pq_arm_rfft_q31 instead of arm_rfft_q31

    config PQ_ARM_RFFT_INIT_Q15
        bool "pq_arm_rfft_init_q15"
        help
          Use API name pq_arm_rfft_init_q15 instead of arm_rfft_init_q15

    config PQ_ARM_RFFT_Q15
        bool "pq_arm_rfft_q15"
        help
          Use API name pq_arm_rfft_q15 instead of arm_rfft_q15

    config PQ_ARM_DCT4_INIT_Q31
        bool "pq_arm_dct4_init_q31"
        help
          Use API name pq_arm_dct4_init_q31 instead of arm_dct4_init_q31

    config PQ_ARM_DCT4_Q31
        bool "pq_arm_dct4_q31"
        help
          Use API name pq_arm_dct4_q31 instead of arm_dct4_q31

    config PQ_ARM_DCT4_INIT_Q15
        bool "pq_arm_dct4_init_q15"
        help
          Use API name pq_arm_dct4_init_q15 instead of arm_dct4_init_q15

    config PQ_ARM_DCT4_Q15
        bool "pq_arm_dct4_q15"
        help
          Use API name pq_arm_dct4_q15 instead of arm_dct4_q15

    config PQ_ARM_FIR_INIT_F32
        bool "pq_arm_fir_init_f32"
        help
          Use API name pq_arm_fir_init_f32 instead of arm_fir_init_f32

    config PQ_ARM_FIR_INIT_Q31
        bool "pq_arm_fir_init_q31"
        help
          Use API name pq_arm_fir_init_q31 instead of arm_fir_init_q31

    config PQ_ARM_FIR_INIT_Q15
        bool "pq_arm_fir_init_q15"
        help
          Use API name pq_arm_fir_init_q15 instead of arm_fir_init_q15

    config PQ_ARM_FIR_F32
        bool "pq_arm_fir_f32"
        help
          Use API name pq_arm_fir_f32 instead of arm_fir_f32

    config PQ_ARM_FIR_Q31
        bool "pq_arm_fir_q31"
        help
          Use API name pq_arm_fir_q31 instead of arm_fir_q31

    config PQ_ARM_FIR_Q15
        bool "pq_arm_fir_q15"
        help
          Use API name pq_arm_fir_q15 instead of arm_fir_q15

    config PQ_ARM_CONV_F32
        bool "pq_arm_conv_f32"
        help
          Use API name pq_arm_conv_f32 instead of arm_conv_f32

    config PQ_ARM_CONV_Q31
        bool "pq_arm_conv_q31"
        help
          Use API name pq_arm_conv_q31 instead of arm_conv_q31

    config PQ_ARM_CONV_Q15
        bool "pq_arm_conv_q15"
        help
          Use API name pq_arm_conv_q15 instead of arm_conv_q15

    config PQ_ARM_CORRELATE_F32
        bool "pq_arm_correlate_f32"
        help
          Use API name pq_arm_correlate_f32 instead of arm_correlate_f32

    config PQ_ARM_CORRELATE_Q31
        bool "pq_arm_correlate_q31"
        help
          Use API name pq_arm_correlate_q31 instead of arm_correlate_q31

    config PQ_ARM_CORRELATE_Q15
        bool "pq_arm_correlate_q15"
        help
          Use API name pq_arm_correlate_q15 instead of arm_correlate_q15

    config PQ_ARM_MAT_INIT_F32
        bool "pq_arm_mat_init_f32"
        help
          Use API name pq_arm_mat_init_f32 instead of arm_mat_init_f32

    config PQ_ARM_MAT_INIT_Q31
        bool "pq_arm_mat_init_q31"
        help
          Use API name pq_arm_mat_init_q31 instead of arm_mat_init_q31

    config PQ_ARM_MAT_INIT_Q15
        bool "pq_arm_mat_init_q15"
        help
          Use API name pq_arm_mat_init_q15 instead of arm_mat_init_q15

    config PQ_ARM_MAT_ADD_F32
        bool "pq_arm_mat_add_f32"
        help
          Use API name pq_arm_mat_add_f32 instead of arm_mat_add_f32

    config PQ_ARM_MAT_ADD_Q31
        bool "pq_arm_mat_add_q31"
        help
          Use API name pq_arm_mat_add_q31 instead of arm_mat_add_q31

    config PQ_ARM_MAT_ADD_Q15
        bool "pq_arm_mat_add_q15"
        help
          Use API name pq_arm_mat_add_q15 instead of arm_mat_add_q15

    config PQ_ARM_MAT_SUB_F32
        bool "pq_arm_mat_sub_f32"
        help
          Use API name pq_arm_mat_sub_f32 instead of arm_mat_sub_f32

    config PQ_ARM_MAT_SUB_Q31
        bool "pq_arm_mat_sub_q31"
        help
          Use API name pq_arm_mat_sub_q31 instead of arm_mat_sub_q31

    config PQ_ARM_MAT_SUB_Q15
        bool "pq_arm_mat_sub_q15"
        help
          Use API name pq_arm_mat_sub_q15 instead of arm_mat_sub_q15

    config PQ_ARM_MAT_MULT_F32
        bool "pq_arm_mat_mult_f32"
        help
          Use API name pq_arm_mat_mult_f32 instead of arm_mat_mult_f32

    config PQ_ARM_MAT_MULT_Q31
        bool "pq_arm_mat_mult_q31"
        help
          Use API name pq_arm_mat_mult_q31 instead of arm_mat_mult_q31

    config PQ_ARM_MAT_MULT_Q15
        bool "pq_arm_mat_mult_q15"
        help
          Use API name pq_arm_mat_mult_q15 instead of arm_mat_mult_q15

    config PQ_ARM_MAT_INVERSE_F32
        bool "pq_arm_mat_inverse_f32"
        help
          Use API name pq_arm_mat_inverse_f32 instead of arm_mat_inverse_f32

    config PQ_ARM_MAT_TRANS_F32
        bool "pq_arm_mat_trans_f32"
        help
          Use API name pq_arm_mat_trans_f32 instead of arm_mat_trans_f32

    config PQ_ARM_MAT_TRANS_Q31
        bool "pq_arm_mat_trans_q31"
        help
          Use API name pq_arm_mat_trans_q31 instead of arm_mat_trans_q31

    config PQ_ARM_MAT_TRANS_Q15
        bool "pq_arm_mat_trans_q15"
        help
          Use API name pq_arm_mat_trans_q15 instead of arm_mat_trans_q15

    config PQ_ARM_MAT_SCALE_F32
        bool "pq_arm_mat_scale_f32"
        help
          Use API name pq_arm_mat_scale_f32 instead of arm_mat_scale_f32

    config PQ_ARM_MAT_SCALE_Q31
        bool "pq_arm_mat_scale_q31"
        help
          Use API name pq_arm_mat_scale_q31 instead of arm_mat_scale_q31

    config PQ_ARM_MAT_SCALE_Q15
        bool "pq_arm_mat_scale_q15"
        help
          Use API name pq_arm_mat_scale_q15 instead of arm_mat_scale_q15

    endmenu
endif
```

## drivers/reformatter/Kconfig
```kconfig
# Copyright 2025 NXP
#
# SPDX-License-Identifier: BSD-3-Clause

config MCUX_HAS_COMPONENT_driver.reformatter
    bool
    default y if MCUX_HW_IP_DriverType_REFORMATTER

config MCUX_COMPONENT_driver.reformatter
    bool "reformatter"
    select MCUX_COMPONENT_driver.common
    depends on MCUX_HAS_COMPONENT_driver.reformatter
```

## drivers/rtc_analog/Kconfig
```kconfig
# Copyright 2025 NXP
#
# SPDX-License-Identifier: BSD-3-Clause

config MCUX_HAS_COMPONENT_driver.rtc_analog
    bool
    default y if MCUX_HW_IP_DriverType_RTC_ANALOG

config MCUX_COMPONENT_driver.rtc_analog
    bool "rtc"
    select MCUX_COMPONENT_driver.common
    depends on MCUX_HAS_COMPONENT_driver.rtc_analog

if MCUX_COMPONENT_driver.rtc_analog

    config RTC_WAIT_INTERFACE_READY_TIMEOUT
        int "RTC wait interface ready timeout"
        default 0
        help
            RTC wait interface ready timeout.
            type unsigned.

    config RTC_WAIT_READ_COUNTER_LATCHED_READY
        bool "RTC wait read counter latched ready"
        default 0
        help
            Wait for the RTC counter to be latched before reading it.
            type unsigned.

    config RTC_WAIT_SECURE_KEY_READY_TIMEOUT
        int "RTC wait secure key ready timeout"
        default 0
        help
            RTC wait secure key ready timeout.
            type unsigned.

endif
```

## drivers/rtc_jdp/Kconfig
```kconfig
# Copyright 2025 NXP
#
# SPDX-License-Identifier: BSD-3-Clause

config MCUX_HAS_COMPONENT_driver.rtc_jdp
    bool
    default y if MCUX_HW_IP_DriverType_RTC_JDP

config MCUX_COMPONENT_driver.rtc_jdp
    bool "rtc_jdp"
    select MCUX_COMPONENT_driver.common
    depends on MCUX_HAS_COMPONENT_driver.rtc_jdp
```

## drivers/sema4/Kconfig
```kconfig
# Copyright 2024-2025 NXP
#
# SPDX-License-Identifier: BSD-3-Clause

config MCUX_HAS_COMPONENT_driver.sema4
    bool
    default y if MCUX_HW_IP_DriverType_SEMA4

config MCUX_COMPONENT_driver.sema4
    bool "sema4"
    select MCUX_COMPONENT_driver.common
    depends on MCUX_HAS_COMPONENT_driver.sema4

config SEMA4_BUSY_POLL_COUNT
    int "Maximum polling iterations for SEMA4 waiting loops (0 means poll indefinitely)"
    default 0
    depends on MCUX_COMPONENT_driver.sema4
    help
      This parameter defines the maximum number of iterations for any polling loop
      in the SEMA4 driver code before timing out and returning an error.

      It applies to all waiting loops in SEMA4 driver, such as waiting for a gate
      to be unlocked, waiting for a reset to complete, or waiting for a resource
      to become available.

      This is a count of loop iterations, not a time-based value.

      If set to 0, polling loops will continue indefinitely until their exit condition
      is met, which could potentially cause the system to hang if hardware doesn't respond
      or if a resource is never released.
```

## drivers/sema42/Kconfig
```kconfig
# Copyright 2024-2025 NXP
#
# SPDX-License-Identifier: BSD-3-Clause

config MCUX_HAS_COMPONENT_driver.sema42
    bool
    default y if MCUX_HW_IP_DriverType_SEMA42

config MCUX_COMPONENT_driver.sema42
    bool "sema42"
    select MCUX_COMPONENT_driver.common
    depends on MCUX_HAS_COMPONENT_driver.sema42

config SEMA42_BUSY_POLL_COUNT
    int "Maximum polling iterations for SEMA42 waiting loops (0 means poll indefinitely)"
    default 0
    depends on MCUX_COMPONENT_driver.sema42
    help
      This parameter defines the maximum number of iterations for any polling loop
      in the SEMA42 driver code before timing out and returning an error.

      It applies to all waiting loops in SEMA42 driver, such as waiting for a gate
      to be unlocked, waiting for a reset to complete, or waiting for a resource
      to become available.

      This is a count of loop iterations, not a time-based value.

      If set to 0, polling loops will continue indefinitely until their exit condition
      is met, which could potentially cause the system to hang if hardware doesn't respond
      or if a resource is never released.
```

## drivers/sfa/Kconfig
```kconfig
# Copyright 2024 NXP
#
# SPDX-License-Identifier: BSD-3-Clause

config MCUX_HAS_COMPONENT_driver.sfa
    bool
    default y if MCUX_HW_IP_DriverType_SFA

config MCUX_COMPONENT_driver.sfa
    bool "sfa"
    select MCUX_COMPONENT_driver.common
    depends on MCUX_HAS_COMPONENT_driver.sfa

if MCUX_COMPONENT_driver.sfa

    config SFA_SRAM_MEASUREMENT_START_TIMEOUT
        int "Max loops to wait for SFA measurement started (0 means wait forever)"
        default 0
        help
          This parameter defines how many loops to check completion before return timeout.
          If defined as 0, driver will wait forever until completion.

endif

if MCUX_COMPONENT_driver.sfa

    config SFA_CUT_COUNTER_STOP_TIMEOUT
        int "Max loops to wait for SFA CUT counter has stopped (0 means wait forever)"
        default 0
        help
          This parameter defines how many loops to check completion before return timeout.
          If defined as 0, driver will wait forever until completion.

endif

if MCUX_COMPONENT_driver.sfa

    config SFA_REF_COUNTER_STOP_TIMEOUT
        int "Max loops to wait for SFA REF counter has stopped (0 means wait forever)"
        default 0
        help
          This parameter defines how many loops to check completion before return timeout.
          If defined as 0, driver will wait forever until completion.

endif
```

## drivers/smartdma/Kconfig
```kconfig
# Copyright 2024-2025 NXP
#
# SPDX-License-Identifier: BSD-3-Clause

config MCUX_HAS_COMPONENT_driver.smartdma
    bool
    default y if MCUX_HW_IP_DriverType_SMARTDMA

config MCUX_COMPONENT_driver.smartdma_rt500
    bool
    depends on MCUX_HW_IP_DriverType_SMARTDMA_RT500

config MCUX_COMPONENT_driver.smartdma_mcxn
    bool
    depends on MCUX_HW_IP_DriverType_SMARTDMA_MCXN

config MCUX_COMPONENT_driver.smartdma_mcxa
    bool
    depends on MCUX_HW_IP_DriverType_SMARTDMA_MCXA

config MCUX_COMPONENT_driver.smartdma
    bool "smartdma"
    select MCUX_COMPONENT_driver.common
    depends on MCUX_HAS_COMPONENT_driver.smartdma
    select MCUX_COMPONENT_driver.smartdma_rt500 if MCUX_HW_IP_DriverType_SMARTDMA_RT500
    select MCUX_COMPONENT_driver.smartdma_mcxn if MCUX_HW_IP_DriverType_SMARTDMA_MCXN
    select MCUX_COMPONENT_driver.smartdma_mcxa if MCUX_HW_IP_DriverType_SMARTDMA_MCXA
```
