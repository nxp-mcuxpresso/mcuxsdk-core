## drivers/lpuart/Kconfig
```kconfig
# Copyright 2024-2025 NXP
#
# SPDX-License-Identifier: BSD-3-Clause

config MCUX_HAS_COMPONENT_driver.lpuart_dma
    bool
    default y if MCUX_HAS_COMPONENT_driver.lpuart && MCUX_HAS_COMPONENT_driver.dma

config MCUX_HAS_COMPONENT_driver.lpuart_edma
    bool
    default y if MCUX_HAS_COMPONENT_driver.lpuart && (MCUX_HAS_COMPONENT_driver.dma3 || MCUX_HAS_COMPONENT_driver.edma || MCUX_HAS_COMPONENT_driver.edma4)

config MCUX_HAS_COMPONENT_driver.lpuart
    bool
    default y if MCUX_HW_IP_DriverType_LPUART

config MCUX_COMPONENT_driver.lpuart_dma
    bool "lpuart_dma"
    select MCUX_COMPONENT_driver.lpuart
    select MCUX_COMPONENT_driver.dma
    depends on MCUX_HAS_COMPONENT_driver.lpuart_dma

config MCUX_COMPONENT_driver.lpuart_edma
    bool "lpuart_edma"
    select MCUX_COMPONENT_driver.lpuart
    select MCUX_COMPONENT_driver.dma3 if MCUX_HAS_COMPONENT_driver.dma3
    select MCUX_COMPONENT_driver.edma if MCUX_HAS_COMPONENT_driver.edma
    select MCUX_COMPONENT_driver.edma4 if MCUX_HAS_COMPONENT_driver.edma4
    depends on MCUX_HAS_COMPONENT_driver.lpuart_edma

config MCUX_COMPONENT_driver.lpuart
    bool "lpuart"
    select MCUX_COMPONENT_driver.common
    depends on MCUX_HAS_COMPONENT_driver.lpuart

if MCUX_COMPONENT_driver.lpuart
    config UART_RETRY_TIMES
        int "Max loops to wait for operation complete (0 means wait forever)"
        default 0
        help
          This parameter defines how many loops to check completion before return timeout.
          If defined as 0, driver will wait forever until completion.
endif
```

## drivers/mau/Kconfig
```kconfig
# Copyright 2024-2025 NXP
#
# SPDX-License-Identifier: BSD-3-Clause

config MCUX_HAS_COMPONENT_driver.mau
    bool
    default y if MCUX_HW_IP_DriverType_MAU

config MCUX_COMPONENT_driver.mau
    bool "mau"
    select MCUX_COMPONENT_driver.common
    depends on MCUX_HAS_COMPONENT_driver.mau

if MCUX_COMPONENT_driver.mau

    config MAU_ENABLE_CMSIS_DSP_API
        bool "Enable MAU CMSIS DSP API"
        select MCUX_COMPONENT_CMSIS_DSP_Include
        help
            Enable the MAU CMSIS DSP API

    config MAU_ENABLE_CMSIS_DSP_ARM_SQRT_F32_API
        bool "Enable MAU arm_sqrt_f32 function"
        depends on MAU_ENABLE_CMSIS_DSP_API
        help
            Enable the MAU CMSIS DSP arm_sqrt_f32 API

endif
```

## drivers/mc_rgm/Kconfig
```kconfig
# Copyright 2025 NXP
#
# SPDX-License-Identifier: BSD-3-Clause

config MCUX_HAS_COMPONENT_driver.mc_rgm
    bool
    default y if MCUX_HW_IP_DriverType_MC_RGM

config MCUX_COMPONENT_driver.mc_rgm
    bool "mc_rgm"
    select MCUX_COMPONENT_driver.common
    depends on MCUX_HAS_COMPONENT_driver.mc_rgm
```

## drivers/mipi_csi2rx_dwc_1/Kconfig
```kconfig
# Copyright 2025 NXP
#
# SPDX-License-Identifier: BSD-3-Clause

config MCUX_HAS_COMPONENT_driver.mipi_csi2rx_dwc_1
    bool
    default y if MCUX_HW_IP_DriverType_MIPI_CSI2_1

config MCUX_COMPONENT_driver.mipi_csi2rx_dwc_1
    bool "Use driver mipi_csi2rx_dwc"
    select MCUX_COMPONENT_driver.common
    depends on MCUX_HAS_COMPONENT_driver.mipi_csi2rx_dwc_1
```

## drivers/mipi_dsi2_dwc/Kconfig
```kconfig
# Copyright 2025 NXP
#
# SPDX-License-Identifier: BSD-3-Clause

config MCUX_HAS_COMPONENT_driver.mipi_dsi2_dwc
    bool
    default y if MCUX_HW_IP_DriverType_MIPI_DSI2

config MCUX_COMPONENT_driver.mipi_dsi2_dwc
    bool "mipi_dsi2_dwc"
    select MCUX_COMPONENT_driver.common
    depends on MCUX_HAS_COMPONENT_driver.mipi_dsi2_dwc
```

## drivers/mipi_dsi_split_1/Kconfig
```kconfig
# Copyright 2025 NXP
#
# SPDX-License-Identifier: BSD-3-Clause

config MCUX_HAS_COMPONENT_driver.mipi_dsi_split_1
    bool
    default y if MCUX_HW_IP_DriverType_MIPI_DSI_SPLIT_1

config MCUX_COMPONENT_driver.mipi_dsi_split_1
    bool "mipi_dsi_split_1"
    select MCUX_COMPONENT_driver.common
    select MCUX_COMPONENT_driver.mipi_dsi_soc
    depends on MCUX_HAS_COMPONENT_driver.mipi_dsi_split_1
```

## drivers/mu/Kconfig
```kconfig
# Copyright 2024-2025 NXP
#
# SPDX-License-Identifier: BSD-3-Clause

config MCUX_HAS_COMPONENT_driver.mu
    bool
    default y if MCUX_HW_IP_DriverType_MU

config MCUX_COMPONENT_driver.mu
    bool "mu"
    select MCUX_COMPONENT_driver.common
    depends on MCUX_HAS_COMPONENT_driver.mu

config MU_BUSY_POLL_COUNT
    int "Maximum polling iterations for MU waiting loops (0 means poll indefinitely)"
    default 0
    depends on MCUX_COMPONENT_driver.mu
    help
      This parameter defines the maximum number of iterations for any polling loop
      in the MU code before timing out and returning an error.

      It applies to all waiting loops in MU driver, such as waiting for TX register
      to be empty or waiting for RX register to be full.

      This is a count of loop iterations, not a time-based value.

      If set to 0, polling loops will continue indefinitely until their exit condition
      is met, which could potentially cause the system to hang if a core becomes
      unresponsive.
```

## drivers/mu1/Kconfig
```kconfig
# Copyright 2024-2025 NXP
#
# SPDX-License-Identifier: BSD-3-Clause

config MCUX_HAS_COMPONENT_driver.mu1
    bool
    default y if MCUX_HW_IP_DriverType_MU_1

config MCUX_COMPONENT_driver.mu1
    bool "mu1"
    select MCUX_COMPONENT_driver.common
    depends on MCUX_HAS_COMPONENT_driver.mu1

config MU1_BUSY_POLL_COUNT
    int "Maximum polling iterations for MU waiting loops (0 means poll indefinitely)"
    default 0
    depends on MCUX_COMPONENT_driver.mu1
    help
      This parameter defines the maximum number of iterations for any polling loop
      in the MU code before timing out and returning an error.

      It applies to all waiting loops in MU driver, such as waiting for TX register
      to be empty or waiting for RX register to be full.

      This is a count of loop iterations, not a time-based value.

      If set to 0, polling loops will continue indefinitely until their exit condition
      is met, which could potentially cause the system to hang if a core becomes
      unresponsive.
```

## drivers/mx25/Kconfig
```kconfig
# Copyright 2024 NXP
#
# SPDX-License-Identifier: BSD-3-Clause

config MCUX_COMPONENT_driver.mx25
    bool "Use driver mx25"
    select MCUX_COMPONENT_driver.spifi_dma
    depends on MCUX_HAS_COMPONENT_driver.spifi_dma
```

## drivers/netc/Kconfig
```kconfig
# Copyright 2024 NXP
#
# SPDX-License-Identifier: BSD-3-Clause

config MCUX_DEPENDENCY_COMPONENT_driver.netc_rt1180
    bool
    default y if MCUX_HW_DEVICE_MIMXRT1189 || MCUX_HW_DEVICE_MIMXRT1187 ||\
                 MCUX_HW_DEVICE_MIMXRT1186 || MCUX_HW_DEVICE_MIMXRT1182 ||\
                 MCUX_HW_DEVICE_MIMXRT1181

config MCUX_DEPENDENCY_COMPONENT_driver.netc_imx95
    bool
    default y if MCUX_HW_DEVICE_MIMX9596 || MCUX_HW_DEVICE_MIMX9594 ||\
                 MCUX_HW_DEVICE_MIMX9586 || MCUX_HW_DEVICE_MIMX9576 ||\
                 MCUX_HW_DEVICE_MIMX9574 || MCUX_HW_DEVICE_MIMX9556 ||\
                 MCUX_HW_DEVICE_MIMX9554 || MCUX_HW_DEVICE_MIMX9546 ||\
                 MCUX_HW_DEVICE_MIMX9536 || MCUX_HW_DEVICE_MIMX9534 ||\
                 MCUX_HW_DEVICE_MIMX95N6 || MCUX_HW_DEVICE_MIMX95N4 ||\
                 MCUX_HW_DEVICE_MIMX9506

config MCUX_DEPENDENCY_COMPONENT_driver.netc_imx943
    bool
    default y if MCUX_HW_DEVICE_MIMX94398

config MCUX_HAS_COMPONENT_driver.netc
    bool
    default y if MCUX_HW_IP_DriverType_NETC

config MCUX_COMPONENT_driver.netc_rt1180
    bool
    depends on MCUX_DEPENDENCY_COMPONENT_driver.netc_rt1180

config MCUX_COMPONENT_driver.netc_imx95
    bool
    depends on MCUX_DEPENDENCY_COMPONENT_driver.netc_imx95

config MCUX_COMPONENT_driver.netc_imx943
    bool
    depends on MCUX_DEPENDENCY_COMPONENT_driver.netc_imx943

config MCUX_COMPONENT_driver.netc
    bool "netc"
    select MCUX_COMPONENT_driver.common
    select MCUX_COMPONENT_driver.netc_rt1180 if MCUX_DEPENDENCY_COMPONENT_driver.netc_rt1180
    select MCUX_COMPONENT_driver.netc_imx95 if MCUX_DEPENDENCY_COMPONENT_driver.netc_imx95
    select MCUX_COMPONENT_driver.netc_imx943 if MCUX_DEPENDENCY_COMPONENT_driver.netc_imx943
    depends on MCUX_HAS_COMPONENT_driver.netc

config MCUX_COMPONENT_driver.netc_switch
    bool "netc switch"
    default y
    depends on MCUX_COMPONENT_driver.netc
    depends on MCUX_DEPENDENCY_COMPONENT_driver.netc_rt1180 || MCUX_DEPENDENCY_COMPONENT_driver.netc_imx943

config MCUX_COMPONENT_driver.netc_phywrapper
    bool "netc phy wrapper"
    default y
    depends on MCUX_COMPONENT_driver.netc
    depends on MCUX_DEPENDENCY_COMPONENT_driver.netc_imx95 || MCUX_DEPENDENCY_COMPONENT_driver.netc_imx943

config MCUX_COMPONENT_driver.netc_msg
    bool "netc VSI-PSI message"
    depends on MCUX_COMPONENT_driver.netc
    depends on MCUX_DEPENDENCY_COMPONENT_driver.netc_imx95
```

## drivers/npx/Kconfig
```kconfig
# Copyright 2025 NXP
#
# SPDX-License-Identifier: BSD-3-Clause

config MCUX_HAS_COMPONENT_driver.npx
    bool
    default y if MCUX_HW_IP_DriverType_NPX

config MCUX_COMPONENT_driver.npx
    bool "npx"
    select MCUX_COMPONENT_driver.common
    depends on MCUX_HAS_COMPONENT_driver.npx
```

## drivers/pls_pmu/Kconfig
```kconfig
# Copyright 2025 NXP
#
# SPDX-License-Identifier: BSD-3-Clause

config MCUX_HAS_COMPONENT_driver.pls_pmu
    bool
    default y if MCUX_HW_IP_DriverType_PMIC

config MCUX_COMPONENT_driver.pls_pmu
    bool "pls_pmu"
    select MCUX_COMPONENT_driver.common
    depends on MCUX_HAS_COMPONENT_driver.pls_pmu

if MCUX_COMPONENT_driver.pls_pmu
    config PLS_PMU_REG_WRITE_DELAY_VAL
        int "Extra delay value in microseconds required between consecutive writes to PMU register."
        default 600
        help
          This delay ensures proper timing between register write operations.
endif
```

## drivers/plu/Kconfig
```kconfig
# Copyright 2024 NXP
#
# SPDX-License-Identifier: BSD-3-Clause

config MCUX_HAS_COMPONENT_driver.plu
    bool
    default y if MCUX_HW_IP_DriverType_PLU

config MCUX_COMPONENT_driver.plu
    bool "Use driver plu"
    select MCUX_COMPONENT_driver.common
    depends on MCUX_HAS_COMPONENT_driver.plu
```
