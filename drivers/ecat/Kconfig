## drivers/lpi2c/Kconfig
```kconfig
# Copyright 2024-2025 NXP
#
# SPDX-License-Identifier: BSD-3-Clause

config MCUX_HAS_COMPONENT_driver.lpi2c_edma
    bool
    default y if MCUX_HAS_COMPONENT_driver.lpi2c && (MCUX_HAS_COMPONENT_driver.dma3 || MCUX_HAS_COMPONENT_driver.edma || MCUX_HAS_COMPONENT_driver.edma4)

config MCUX_HAS_COMPONENT_driver.lpi2c
    bool
    default y if MCUX_HW_IP_DriverType_LPI2C

config MCUX_COMPONENT_driver.lpi2c_edma
    bool "lpi2c_edma"
    select MCUX_COMPONENT_driver.lpi2c
    select MCUX_COMPONENT_driver.dma3 if MCUX_HAS_COMPONENT_driver.dma3
    select MCUX_COMPONENT_driver.edma if MCUX_HAS_COMPONENT_driver.edma
    select MCUX_COMPONENT_driver.edma4 if MCUX_HAS_COMPONENT_driver.edma4
    depends on MCUX_HAS_COMPONENT_driver.lpi2c_edma

config MCUX_COMPONENT_driver.lpi2c
    bool "lpi2c"
    select MCUX_COMPONENT_driver.common
    depends on MCUX_HAS_COMPONENT_driver.lpi2c

if MCUX_COMPONENT_driver.lpi2c
    config I2C_RETRY_TIMES
        int "Max loops to wait for operation complete (0 means wait forever)"
        default 0
        help
          This parameter defines how many loops to check completion before return timeout.
          If defined as 0, driver will wait forever until completion.
endif
```

## drivers/lpit/Kconfig
```kconfig
# Copyright 2024 NXP
#
# SPDX-License-Identifier: BSD-3-Clause

config MCUX_HAS_COMPONENT_driver.lpit
    bool
    default y if MCUX_HW_IP_DriverType_LPIT

config MCUX_COMPONENT_driver.lpit
    bool "lpit"
    select MCUX_COMPONENT_driver.common
    depends on MCUX_HAS_COMPONENT_driver.lpit

if MCUX_COMPONENT_driver.lpit

    config LPIT_RESET_STATE_DELAY
        int "LPIT reset delay loop count"
        default 120
        help
          Type unsigned. Loop count to control the delay time to perform reliable LPIT reset.
          Its value shall be at least 4 * core clock / LPIT peripheral clock.
endif
```
