## drivers/ecat/Kconfig
```kconfig
config MCUX_HAS_COMPONENT_driver.ecat
    bool
    default y if MCUX_HW_IP_DriverType_ECAT

config MCUX_COMPONENT_driver.ecat
    bool "Use driver ecat"
    select MCUX_COMPONENT_driver.common
    depends on MCUX_HAS_COMPONENT_driver.ecat
```

## drivers/ela_csec/Kconfig
```kconfig
# Copyright 2024-2025 NXP
#
# SPDX-License-Identifier: BSD-3-Clause

config MCUX_HAS_COMPONENT_driver.ela_csec
    bool
    default y if MCUX_HW_IP_DriverType_CSEC

config MCUX_COMPONENT_driver.ela_csec
    bool "ela_csec"
    select MCUX_COMPONENT_driver.common
    depends on MCUX_HAS_COMPONENT_driver.ela_csec
```

## drivers/emios/Kconfig
```kconfig
# Copyright 2025 NXP
#
# SPDX-License-Identifier: BSD-3-Clause

config MCUX_HAS_COMPONENT_driver.eMIOS
    bool
    default y if MCUX_HW_IP_DriverType_EMIOS

config MCUX_COMPONENT_driver.eMIOS
    bool "eMIOS"
    select MCUX_COMPONENT_driver.common
    depends on MCUX_HAS_COMPONENT_driver.eMIOS
```

## drivers/endat2p2/Kconfig
```kconfig
# SPDX-License-Identifier: BSD-3-Clause

config MCUX_HAS_COMPONENT_driver.endat2p2
    bool
    default y if MCUX_HW_IP_DriverType_ENDAT2P2

config MCUX_COMPONENT_driver.endat2p2
    bool "EnDat2.2"
    select MCUX_COMPONENT_driver.common
    depends on MCUX_HAS_COMPONENT_driver.endat2p2
```

## drivers/endat3/Kconfig
```kconfig
# Copyright 2025 NXP
#
# SPDX-License-Identifier: BSD-3-Clause

config MCUX_HAS_COMPONENT_driver.endat3
	bool
	default y if MCUX_HW_IP_DriverType_ENDAT3

config MCUX_COMPONENT_driver.endat3
    bool "Use driver Endat3"
    select MCUX_COMPONENT_driver.common
    depends on MCUX_HAS_COMPONENT_driver.endat3
```

## drivers/espi/Kconfig
```kconfig
# Copyright 2026 NXP
#
# SPDX-License-Identifier: BSD-3-Clause

config MCUX_HAS_COMPONENT_driver.espi
    bool
    default y if MCUX_HW_IP_DriverType_ESPI

config MCUX_COMPONENT_driver.espi
    bool "espi"
    depends on MCUX_HAS_COMPONENT_driver.espi
```

## drivers/flash/Kconfig
```kconfig
# Copyright 2024 NXP
#
# SPDX-License-Identifier: BSD-3-Clause

config MCUX_HAS_COMPONENT_driver.flash
    bool
    default y if MCUX_HW_IP_DriverType_FTFE || MCUX_HW_IP_DriverType_FTFA || MCUX_HW_IP_DriverType_FTFL || MCUX_HW_IP_DriverType_FTFC

config MCUX_COMPONENT_driver.flash
    bool "flash"
    select MCUX_COMPONENT_driver.common
    depends on MCUX_HAS_COMPONENT_driver.flash


if MCUX_COMPONENT_driver.flash
    menu "Flash examples"

#        # This is problematic with current pflash example structure
#        # needs refactoring the example first
#
#        config IFLASH_TEST_USE_SECTOR_INDEX_FROM_END
#        int "Test flash on a specified sector number from the end"
#        default 1
#        help
#            Run flash test on a specified sector number counting from
#            the end of flash.
#
#        config IFLASH_TEST_USE_ADDRESS
#        hex "Test flash on a specified address"
#        default 0
#        help
#            Instead of using a sector number from the end of flash
#            use an explicit address. This must be sector aligned non-zero
#            value.

        config  IFLASH_EXPLICIT_DEVICE_CONFIG_VALUES
        bool "Use non-default device specific configuration"
        default n
        help
            Flash examples that require device specific configuration
            can use either default values or values specified by Kconfig.

        if IFLASH_EXPLICIT_DEVICE_CONFIG_VALUES

            config IFLASH_DEPART_CODE
            hex "FlexNVM partition code"
            help
                Device specific value that determines how the data flash
                will be split between area for data and area for emulated
                EEPROM. See device RM for possible values.

            config IFLASH_EEESIZE_CODE
            hex "EEPROM size code"
            help
                Device specific value that configures size for EEPROM emulated
                data. The frontend of this interface is SRAM memory of the
                specified size. The backend is located in DFlash where the actual
                data is stored.

        endif

    endmenu
endif
```

## drivers/flash_c40/Kconfig
```kconfig
# Copyright 2025 NXP
#
# SPDX-License-Identifier: BSD-3-Clause

config MCUX_HAS_COMPONENT_driver.flash_c40
    bool
    default y if MCUX_HW_IP_DriverType_FLASH_C40

config MCUX_COMPONENT_driver.flash_c40
    bool "flash_c40"
    select MCUX_COMPONENT_driver.common
    depends on MCUX_HAS_COMPONENT_driver.flash_c40
```

## drivers/flexio/a-format/Kconfig
```kconfig
# Copyright 2025 NXP
#
# SPDX-License-Identifier: BSD-3-Clause

config MCUX_HAS_COMPONENT_driver.flexio_a-format
    bool
    default y if MCUX_HW_IP_DriverType_FLEXIO_A-FORMAT

config MCUX_COMPONENT_driver.flexio_a-format
    bool "flexio_a-format"
    select MCUX_COMPONENT_driver.flexio
    depends on MCUX_HAS_COMPONENT_driver.flexio_a-format
```

## drivers/flexio/endat2p2/Kconfig
```kconfig
# Copyright 2025 NXP
#
# SPDX-License-Identifier: BSD-3-Clause

config MCUX_HAS_COMPONENT_driver.flexio_endat2p2
    bool
    default y if MCUX_HW_IP_DriverType_FLEXIO_ENDAT2P2

config MCUX_COMPONENT_driver.flexio_endat2p2
    bool "flexio_endat2.2"
    select MCUX_COMPONENT_driver.flexio
    depends on MCUX_HAS_COMPONENT_driver.flexio_endat2p2
```

## drivers/flexio/i2c/Kconfig
```kconfig
# Copyright 2024-2025 NXP
#
# SPDX-License-Identifier: BSD-3-Clause

config MCUX_COMPONENT_driver.flexio_i2c_master
    bool "flexio_i2c_master"
    select MCUX_COMPONENT_driver.flexio
    depends on MCUX_HAS_COMPONENT_driver.flexio

if MCUX_COMPONENT_driver.flexio_i2c_master
    config I2C_RETRY_TIMES
        int "Max loops to wait for operation complete (0 means wait forever)"
        default 0
        help
          This parameter defines how many loops to check completion before return timeout.
          If defined as 0, driver will wait forever until completion.
endif
```

## drivers/flexio/t-format/Kconfig
```kconfig
# Copyright 2025 NXP
#
# SPDX-License-Identifier: BSD-3-Clause

config MCUX_HAS_COMPONENT_driver.flexio_t-format
    bool
    default y if MCUX_HW_IP_DriverType_FLEXIO_T-FORMAT

config MCUX_COMPONENT_driver.flexio_t-format
    bool "flexio_t-format"
    select MCUX_COMPONENT_driver.flexio
    depends on MCUX_HAS_COMPONENT_driver.flexio_t-format
```

## drivers/flexspi/flexspi_dma3/Kconfig
```kconfig
# Copyright 2024 NXP
#
# SPDX-License-Identifier: BSD-3-Clause

config MCUX_HAS_COMPONENT_driver.flexspi_dma3
    bool
    default y if MCUX_HAS_COMPONENT_driver.flexspi && (MCUX_HAS_COMPONENT_driver.dma3)

config MCUX_COMPONENT_driver.flexspi_dma3
    bool "flexspi_dma3"
    select MCUX_COMPONENT_driver.flexspi
    select MCUX_COMPONENT_driver.dma3 if MCUX_HAS_COMPONENT_driver.dma3
    depends on MCUX_HAS_COMPONENT_driver.flexspi_dma3
```

## drivers/hiperface/Kconfig
```kconfig
# Copyright 2025 NXP
#
# SPDX-License-Identifier: BSD-3-Clause

config MCUX_HAS_COMPONENT_driver.hiperface
	bool
	default y if MCUX_HW_IP_DriverType_HIPERFACE

config MCUX_COMPONENT_driver.hiperface
    bool "Use driver Hiperface"
    select MCUX_COMPONENT_driver.common
    depends on MCUX_HAS_COMPONENT_driver.hiperface
```

## drivers/i3c/Kconfig
```kconfig
# Copyright 2024 NXP
#
# SPDX-License-Identifier: BSD-3-Clause

config MCUX_HAS_COMPONENT_driver.i3c_dma
    bool
    default y if MCUX_HAS_COMPONENT_driver.i3c && MCUX_HAS_COMPONENT_driver.lpc_dma

config MCUX_HAS_COMPONENT_driver.i3c_edma
    bool
    default y if MCUX_HAS_COMPONENT_driver.i3c && MCUX_HAS_COMPONENT_driver.edma4

config MCUX_HAS_COMPONENT_driver.i3c
    bool
    default y if MCUX_HW_IP_DriverType_I3C

config MCUX_COMPONENT_driver.i3c_dma
    bool "i3c_dma"
    select MCUX_COMPONENT_driver.i3c
    select MCUX_COMPONENT_driver.lpc_dma
    depends on MCUX_HAS_COMPONENT_driver.i3c_dma

config MCUX_COMPONENT_driver.i3c_edma
    bool "i3c_edma"
    select MCUX_COMPONENT_driver.i3c
    select MCUX_COMPONENT_driver.edma4
    depends on MCUX_HAS_COMPONENT_driver.i3c_edma

config MCUX_COMPONENT_driver.i3c
    bool "i3c"
    select MCUX_COMPONENT_driver.common
    depends on MCUX_HAS_COMPONENT_driver.i3c

if MCUX_COMPONENT_driver.i3c
    config I3C_RETRY_TIMES
        int "Max loops to wait for I3C operation status complete (0 means wait forever)"
        default 0
        help
            This is the maximum number of loops to wait for I3C operation status complete.
            If set to 0, it will wait indefinitely.
endif
```

## drivers/igf/Kconfig
```kconfig
# Copyright 2025 NXP
#
# SPDX-License-Identifier: BSD-3-Clause

config MCUX_HAS_COMPONENT_driver.igf
    bool
    default y if MCUX_HW_IP_DriverType_IGF

config MCUX_COMPONENT_driver.igf
    bool "igf"
    select MCUX_COMPONENT_driver.common
    depends on MCUX_HAS_COMPONENT_driver.igf
```

## drivers/imu/Kconfig
```kconfig
# Copyright 2024-2025 NXP
#
# SPDX-License-Identifier: BSD-3-Clause

config MCUX_HAS_COMPONENT_driver.imu
    bool
    default y if MCUX_HW_IP_DriverType_CNS_CIU1_IMU || MCUX_HW_IP_DriverType_CNS_CIU2_IMU || MCUX_HW_IP_DriverType_IMU

config MCUX_COMPONENT_driver.imu
    bool "imu"
    select MCUX_COMPONENT_driver.common
    depends on MCUX_HAS_COMPONENT_driver.imu

config IMU_BUSY_POLL_COUNT
    int "Maximum polling iterations for IMU waiting loops (0 means poll indefinitely)"
    default 0
    depends on MCUX_COMPONENT_driver.imu
    help
      This parameter defines the maximum number of iterations for any polling loop
      in the IMU driver code before timing out and returning an error.

      It applies to all waiting loops in IMU driver.

      This is a count of loop iterations, not a time-based value.

      If set to 0, polling loops will continue indefinitely until their exit condition
      is met, which could potentially cause the system to hang if sensors don't respond
      or if communication interfaces fail.
```

## drivers/irqsteer_1/Kconfig
```kconfig
# Copyright 2024 NXP
#
# SPDX-License-Identifier: BSD-3-Clause

config MCUX_HAS_COMPONENT_driver.irqsteer_1
    bool
    default y if MCUX_HW_IP_DriverType_IRQSTEER_1

config MCUX_COMPONENT_driver.irqsteer_1
    bool "irqsteer_1 - depends on irqsteer_1_soc/irqsteer_1_soc.${core_id} driver"
    select MCUX_COMPONENT_driver.common
    depends on MCUX_HAS_COMPONENT_driver.irqsteer_1
```

## drivers/lcdic/Kconfig
```kconfig
# Copyright 2024 NXP
#
# SPDX-License-Identifier: BSD-3-Clause

config MCUX_HAS_COMPONENT_driver.lcdic_dma
    bool
    default y if MCUX_HAS_COMPONENT_driver.lcdic && MCUX_HAS_COMPONENT_driver.lpc_dma

config MCUX_HAS_COMPONENT_driver.lcdic
    bool
    default y if MCUX_HW_IP_DriverType_LCDIC

config MCUX_COMPONENT_driver.lcdic_dma
    bool "lcdic_dma"
    select MCUX_COMPONENT_driver.lcdic
    select MCUX_COMPONENT_driver.lpc_dma
    depends on MCUX_HAS_COMPONENT_driver.lcdic_dma

config MCUX_COMPONENT_driver.lcdic
    bool "lcdic"
    select MCUX_COMPONENT_driver.common
    depends on MCUX_HAS_COMPONENT_driver.lcdic

if MCUX_COMPONENT_driver.lcdic

    config LCDIC_RESET_STATE_DELAY
        int "LCDIC reset delay loop"
        default 130
        help
          Loop count to control the delay time to perform reliable LCDIC reset.
          It should make LCDIC_ResetStateDelay longer than 4 LCDIC functional clock.

    config LCDIC_WAIT_CMD_DONE_TIMEOUT
        int "LCDIC CMD done wait loop"
        default 0
        help
          How many loops will driver check hardware status while waiting for command done.
          Use 0 to wait infinitely.

endif
```

## drivers/lin/Kconfig
```kconfig
# Copyright 2024 NXP
#
# SPDX-License-Identifier: BSD-3-Clause

config MCUX_HAS_COMPONENT_driver.lin_lpuart
    bool
    default y if MCUX_HW_IP_DriverType_LPUART_LIN

config MCUX_HAS_COMPONENT_driver.lin
    bool
    default y if MCUX_HW_IP_DriverType_LPUART_LIN

config MCUX_COMPONENT_driver.lin_lpuart
    bool "lin_lpuart"
    select MCUX_COMPONENT_driver.common
    depends on MCUX_HAS_COMPONENT_driver.lin_lpuart

config MCUX_COMPONENT_driver.lin
    bool "lin"
    select MCUX_COMPONENT_driver.lin_lpuart
    depends on MCUX_HAS_COMPONENT_driver.lin

if MCUX_COMPONENT_driver.lin_lpuart

    config LIN_LPUART_TRANSMISSION_COMPLETE_TIMEOUT
        int "Max loops to wait for LIN LPUART transmission complete (0 means wait forever)"
        default 0
        help
          When de-initializing the LIN LPUART module, the program shall wait for the previous
          transmission to complete. This parameter defines how many loops to check
          completion before return error. If defined as 0, driver will wait forever until completion.

endif
```

## drivers/lpacmp/Kconfig
```kconfig
# Copyright 2025 NXP
#
# SPDX-License-Identifier: BSD-3-Clause

config MCUX_HAS_COMPONENT_driver.lpacmp
    bool
    default y if MCUX_HW_IP_DriverType_LPACMP

config MCUX_COMPONENT_driver.lpacmp
    bool "lpacmp"
    select MCUX_COMPONENT_driver.common
    depends on MCUX_HAS_COMPONENT_driver.lpacmp
```

## drivers/lpadc/Kconfig
```kconfig
# Copyright 2024 NXP
#
# SPDX-License-Identifier: BSD-3-Clause

config MCUX_HAS_COMPONENT_driver.lpadc
    bool
    default y if MCUX_HW_IP_DriverType_LPADC

config MCUX_COMPONENT_driver.lpadc
    bool "lpadc"
    select MCUX_COMPONENT_driver.common
    depends on MCUX_HAS_COMPONENT_driver.lpadc

if MCUX_COMPONENT_driver.lpadc

    config LPADC_CONVERSION_COMPLETE_TIMEOUT
        int "Max loops to wait for LPADC conversion complete (0 means wait forever)"
        default 0
        help
          When doing calibration, driver will wait for the completion of conversion.
          This parameter defines how many loops to check completion before return timeout.
          If defined as 0, driver will wait forever until completion.

    config LPADC_CALIBRATION_READY_TIMEOUT
        int "Max loops to wait for LPADC calibration ready (0 means wait forever)"
        default 0
        help
          Before doing calibration, driver will wait for the calibration ready.
          This parameter defines how many loops to check the calibration ready.
          If defined as 0, driver will wait forever until ready.

    config LPADC_GAIN_CAL_READY_TIMEOUT
        int "Max loops to wait for LPADC gain calibration GAIN_CAL ready (0 means wait forever)"
        default 0
        help
          Before doing calibration, driver will wait for the gain calibration GAIN_CAL ready.
          This parameter defines how many loops to check the gain calibration GAIN_CAL ready.
          If defined as 0, driver will wait forever until ready.

endif
```

## drivers/lpc_i2c/Kconfig
```kconfig
# Copyright 2024-2025 NXP
#
# SPDX-License-Identifier: BSD-3-Clause

config MCUX_HAS_COMPONENT_driver.lpc_i2c
    bool
    default y if MCUX_HW_IP_DriverType_I2C_SERIALIF

config MCUX_COMPONENT_driver.lpc_i2c
    bool "lpc_i2c"
    select MCUX_COMPONENT_driver.common
    depends on MCUX_HAS_COMPONENT_driver.lpc_i2c
```
