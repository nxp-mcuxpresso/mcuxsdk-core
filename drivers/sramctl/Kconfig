## drivers/sramctl/Kconfig
```kconfig
# Copyright 2025 NXP
#
# SPDX-License-Identifier: BSD-3-Clause

config MCUX_HAS_COMPONENT_driver.sramctl
    bool
    default y if MCUX_HW_IP_DriverType_SRAMCTL

config MCUX_COMPONENT_driver.sramctl
    bool "Use driver sramctl"
    select MCUX_COMPONENT_driver.common
    depends on MCUX_HAS_COMPONENT_driver.sramctl
```

## drivers/stm/Kconfig
```kconfig
# Copyright 2025 NXP
#
# SPDX-License-Identifier: BSD-3-Clause
config MCUX_HAS_COMPONENT_driver.stm
    bool
    default y if MCUX_HW_IP_DriverType_STM

config MCUX_COMPONENT_driver.stm
    bool "System timer module driver"
    select MCUX_COMPONENT_driver.common
    depends on MCUX_HAS_COMPONENT_driver.stm
```

## drivers/swt/Kconfig
```kconfig
# Copyright 2025 NXP
#
# SPDX-License-Identifier: BSD-3-Clause

config MCUX_HAS_COMPONENT_driver.swt
    bool
    default y if MCUX_HW_IP_DriverType_SWT

config MCUX_COMPONENT_driver.swt
    bool "swt"
    select MCUX_COMPONENT_driver.common
    depends on MCUX_HAS_COMPONENT_driver.swt
```

## drivers/syspm/Kconfig
```kconfig
# Copyright 2024-2025 NXP
#
# SPDX-License-Identifier: BSD-3-Clause

config MCUX_HAS_COMPONENT_driver.syspm
    bool
    default y if MCUX_HW_IP_DriverType_SYSPM

config MCUX_COMPONENT_driver.syspm
    bool "syspm"
    select MCUX_COMPONENT_driver.common
    depends on MCUX_HAS_COMPONENT_driver.syspm

if MCUX_COMPONENT_driver.syspm

    config EVENT_COUNT_STABLE_TIMEOUT
        int "Max loops to wait for SYSPM event count stable (0 means wait forever)"
        default 0

    config INSTRUCTION_COUNT_STABLE_TIMEOUT
        int "Max loops to wait for SYSPM instruction count stable (0 means wait forever)"
        default 0

endif
```

## drivers/tempsense/Kconfig
```kconfig
# Copyright 2025 NXP
#
# SPDX-License-Identifier: BSD-3-Clause

config MCUX_HAS_COMPONENT_driver.tempsense
    bool
    default y if MCUX_HW_IP_DriverType_TEMPSENSE

config MCUX_COMPONENT_driver.tempsense
    bool "tempsense"
    select MCUX_COMPONENT_driver.common
    depends on MCUX_HAS_COMPONENT_driver.tempsense
```

## drivers/tmu/Kconfig
```kconfig
# Copyright 2024 NXP
#
# SPDX-License-Identifier: BSD-3-Clause

config MCUX_HAS_COMPONENT_driver.tmu
    bool
    default y if MCUX_HW_IP_DriverType_TMU

config MCUX_COMPONENT_driver.tmu
    bool "Use driver tmu"
    select MCUX_COMPONENT_driver.common
    depends on MCUX_HAS_COMPONENT_driver.tmu
```

## drivers/tpm/Kconfig
```kconfig
# Copyright 2024-2025 NXP
#
# SPDX-License-Identifier: BSD-3-Clause

config MCUX_HAS_COMPONENT_driver.tpm
    bool
    default y if MCUX_HW_IP_DriverType_TPM

config MCUX_COMPONENT_driver.tpm
    bool "tpm"
    select MCUX_COMPONENT_driver.common
    depends on MCUX_HAS_COMPONENT_driver.tpm

if MCUX_COMPONENT_driver.tpm
    config TPM_TIMEOUT
        int "Max loops to wait tpm register write complete (0 means wait forever)"
        default 0
        help
            This is the maximum number of loops to wait for the tpm register write complete.
            If set to 0, it will wait indefinitely until the register write complete.
endif
```

## drivers/tspc/Kconfig
```kconfig
# Copyright 2025 NXP
#
# SPDX-License-Identifier: BSD-3-Clause

config MCUX_HAS_COMPONENT_driver.tspc
    bool
    default y if MCUX_HW_IP_DriverType_TSPC

config MCUX_COMPONENT_driver.tspc
    bool "tspc"
    select MCUX_COMPONENT_driver.common
    depends on MCUX_HAS_COMPONENT_driver.tspc
```

## drivers/vbat/Kconfig
```kconfig
# Copyright 2024 NXP
#
# SPDX-License-Identifier: BSD-3-Clause

config MCUX_HAS_COMPONENT_driver.vbat
    bool
    default y if MCUX_HW_IP_DriverType_VBAT

config MCUX_COMPONENT_driver.vbat
    bool "vbat"
    select MCUX_COMPONENT_driver.common
    depends on MCUX_HAS_COMPONENT_driver.vbat

if MCUX_COMPONENT_driver.vbat

    config VBAT_LDO_READY_TIMEOUT
        int "Max loops to wait for VBAT LDO ready (0 means wait forever)"
        default 0
        help
          When configuring the LDO, driver will wait for LDO ready.
          This parameter defines how many loops to check completion 
          before return timeout. If defined as 0, driver will wait
          forever until completion.
endif
```

## drivers/virt_wrapper/Kconfig
```kconfig
# Copyright 2025 NXP
#
# SPDX-License-Identifier: BSD-3-Clause

config MCUX_HAS_COMPONENT_driver.virt_wrapper
    bool
    default y if MCUX_HW_IP_DriverType_VIRT_WRAPPER

config MCUX_COMPONENT_driver.virt_wrapper
    bool "virt_wrapper"
    select MCUX_COMPONENT_driver.common
    depends on MCUX_HAS_COMPONENT_driver.virt_wrapper
```

## drivers/vref/Kconfig
```kconfig
# Copyright 2024 NXP
#
# SPDX-License-Identifier: BSD-3-Clause

config MCUX_HAS_COMPONENT_driver.vref
    bool
    default y if MCUX_HW_IP_DriverType_VREF

config MCUX_COMPONENT_driver.vref
    bool "vref"
    select MCUX_COMPONENT_driver.common
    depends on MCUX_HAS_COMPONENT_driver.vref

if MCUX_COMPONENT_driver.vref

    config VREF_INTERNAL_VOLTAGE_STABLE_TIMEOUT
        int "Max loops to wait for VREF internal voltage stable (0 means wait forever)"
        default 0
        help
          This parameter defines how many loops to check completion before return timeout.
          If defined as 0, driver will wait forever until completion.

endif
```

## drivers/wdog32/Kconfig
```kconfig
# Copyright 2024 NXP
#
# SPDX-License-Identifier: BSD-3-Clause

config MCUX_HAS_COMPONENT_driver.wdog32
    bool
    default y if MCUX_HW_IP_DriverType_WDOG32

config MCUX_COMPONENT_driver.wdog32
    bool "wdog32"
    select MCUX_COMPONENT_driver.common
    depends on MCUX_HAS_COMPONENT_driver.wdog32

if MCUX_COMPONENT_driver.wdog32
    config WDOG32_UNLOCK_TIMEOUT
        int "Max loops to wait wdog32 unlock sequence complete (0 means wait forever)"
        default 0
        help
            This is the maximum number of loops to wait for the wdog32 unlock sequence to complete.
            If set to 0, it will wait indefinitely until the unlock sequence is complete.

    config WDOG32_RECONFIG_TIMEOUT
        int "Max loops to wait for wdog32 reconfiguration complete (0 means wait forever)"
        default 0
        help
            This is the maximum number of loops to wait for the wdog32 reconfiguration to complete.
            If set to 0, it will wait indefinitely until the reconfiguration is complete.
endif
```

## drivers/wkpu/Kconfig
```kconfig
# Copyright 2025 NXP
#
# SPDX-License-Identifier: BSD-3-Clause

config MCUX_HAS_COMPONENT_driver.wkpu
    bool
    default y if MCUX_HW_IP_DriverType_WKPU

config MCUX_COMPONENT_driver.wkpu
    bool "wkpu"
    select MCUX_COMPONENT_driver.common
    depends on MCUX_HAS_COMPONENT_driver.wkpu
```

## middleware/cadence/Kconfig
```kconfig
#
# Copyright 2024 NXP
#
# SPDX-License-Identifier: BSD-3-Clause
#

menu "cadence"
    orsource "codecs/Kconfig"
    orsource "multicore-xaf/Kconfig"
    orsource "naturedsp/Kconfig"
    orsource "nnlib/Kconfig"
endmenu
```

## middleware/canopennode/Kconfig
```kconfig
menuconfig MCUX_COMPONENT_middleware.canopennode
    bool "CANopenNode"
    select MCUX_COMPONENT_driver.flexcan
    depends on MCUX_HAS_COMPONENT_driver.flexcan

if MCUX_COMPONENT_middleware.canopennode

config MCUX_COMPONENT_middleware.canopennode.301
    bool "CiA 301"

config MCUX_COMPONENT_middleware.canopennode.303
    bool "CiA 303"

config MCUX_COMPONENT_middleware.canopennode.304
    bool "CiA 304"

config MCUX_COMPONENT_middleware.canopennode.305
    bool "CiA 305"

config MCUX_COMPONENT_middleware.canopennode.309
    bool "CiA 309"

config MCUX_COMPONENT_middleware.canopennode.extra
    bool "CANopen trace"

config MCUX_COMPONENT_middleware.canopennode.storage
    bool "Storage"

endif
```
