## drivers/rt2k_pmu/Kconfig
```kconfig
# Copyright 2025 NXP
#
# SPDX-License-Identifier: BSD-3-Clause

config MCUX_HAS_COMPONENT_driver.rt2k_pmu
    bool
    default y if MCUX_HW_IP_DriverType_RT2K_PMU

config MCUX_COMPONENT_driver.rt2k_pmu
    bool "rt2k_pmu"
    select MCUX_COMPONENT_driver.common
    depends on MCUX_HAS_COMPONENT_driver.rt2k_pmu

if MCUX_COMPONENT_driver.rt2k_pmu
    config PMU_BB_UPDATE_TIMEOUT
    int "Max loops to wait for PMU body bias update done."
    default 0
    help
        The PMU_BB_CFG_DONE bit field will be set once new
        settings of body bias completed.
        If defined as 0, the driver will wait until completion.

endif
```

## drivers/smm/Kconfig
```kconfig
# Copyright 2025 NXP
#
# SPDX-License-Identifier: BSD-3-Clause

config MCUX_HAS_COMPONENT_driver.smm
    bool
    default y if MCUX_HW_IP_DriverType_SMM

config MCUX_COMPONENT_driver.smm
    bool "smm"
    select MCUX_COMPONENT_driver.common
    depends on MCUX_HAS_COMPONENT_driver.smm

if MCUX_COMPONENT_driver.smm

    config SMM_CM33_CORE_FREQUENCY
        int "CM33 core frequency in Hz"
        default 96000000
        help
            This parameter defines the CM33 core frequency in Hz. It is used to calculate the delay time for the SMM driver.
    
    config SMM_CM0P_CORE_FREQUENCY
        int "CM0+ core frequency in Hz"
        default 32768
        help
            This parameter defines the CM0+ core frequency in Hz. It is used to calculate the delay time for the SMM driver.

endif
```

## drivers/xecc/Kconfig
```kconfig
# Copyright 2024, 2026 NXP
#
# SPDX-License-Identifier: BSD-3-Clause

config MCUX_HAS_COMPONENT_driver.xecc
    bool
    default y if MCUX_HW_IP_DriverType_XECC

config MCUX_COMPONENT_driver.xecc
    bool "xecc"
    select MCUX_COMPONENT_driver.common
    depends on MCUX_HAS_COMPONENT_driver.xecc
```

## middleware/mstp-lib/Kconfig
```kconfig
config MCUX_COMPONENT_middleware.mstp-lib
    bool "mstp-lib"
    help
      Enable the mstp-lib library to support MSTP (Multiple Spanning Tree Protocol)
      and RSTP (Rapid Spanning Tree Protocol) as defined in IEEE 802.1Q/802.1D.
```
