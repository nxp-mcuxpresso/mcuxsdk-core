## arch/arm/configuration/Kconfig
```kconfig
# Copyright 2024-2025 NXP
#
# SPDX-License-Identifier: BSD-3-Clause

config MCUX_PRJSEG_config.arm.warn_as_error
    bool

config MCUX_PRJSEG_config.arm.suppress.warn_as_error
    bool "Disable warnings-as-errors"
    default n
    help
        Turn off warn as error globally for ARM project segment.

config MCUX_PRJSEG_config.arm.shared
    bool
    imply MCUX_COMPONENT_utilities.misc_utilities
    imply MCUX_PRJSEG_config.arm.warn_as_error if !MCUX_PRJSEG_config.arm.suppress.warn_as_error

config MCUX_PRJSEG_config.kinetis.shared
    bool
    default y if MCUX_HW_SOC_SERIES_KINETIS
    imply MCUX_PRJSEG_config.arm.shared

config MCUX_PRJSEG_config.rt.shared
    bool
    default y if MCUX_HW_SOC_SERIES_RT
    imply MCUX_PRJSEG_config.arm.shared

config MCUX_PRJSEG_config.imx.shared
    bool
    default y if MCUX_HW_SOC_SERIES_MIMX
    imply MCUX_PRJSEG_config.arm.shared

config MCUX_PRJSEG_config.imx.cortex_a.shared
    bool
    default y if (MCUX_PRJSEG_config.imx.shared && CPU_CORTEX_A)

config MCUX_PRJSEG_config.imx.cortex_m.shared
    bool
    default y if (MCUX_PRJSEG_config.imx.shared && CPU_CORTEX_M)

config MCUX_PRJSEG_config.lpc.shared
    bool
    default y if MCUX_HW_SOC_SERIES_LPC
    imply MCUX_PRJSEG_config.arm.shared

config MCUX_PRJSEG_config.mcx.shared
    bool
    default y if MCUX_HW_SOC_SERIES_MCX
    imply MCUX_PRJSEG_config.arm.shared

config MCUX_PRJSEG_config.wireless.shared
    bool
    default y if MCUX_HW_SOC_SERIES_WIRELESS
    imply MCUX_PRJSEG_config.arm.shared

config MCUX_PRJSEG_config.device_core.define
    bool
    default y
```

## drivers/asrc/Kconfig
```kconfig
# Copyright 2024 NXP
#
# SPDX-License-Identifier: BSD-3-Clause

config MCUX_HAS_COMPONENT_driver.asrc_edma
    bool
    default y if MCUX_HAS_COMPONENT_driver.asrc && (MCUX_HAS_COMPONENT_driver.edma || MCUX_HAS_COMPONENT_driver.edma_unified)

config MCUX_HAS_COMPONENT_driver.asrc
    bool
    default y if MCUX_HW_IP_DriverType_ASRC

config MCUX_COMPONENT_driver.asrc_edma
    bool "asrc_edma"
    select MCUX_COMPONENT_driver.asrc
    select MCUX_COMPONENT_driver.edma if MCUX_HAS_COMPONENT_driver.edma
    select MCUX_COMPONENT_driver.edma_unified if MCUX_HAS_COMPONENT_driver.edma_unified
    depends on MCUX_HAS_COMPONENT_driver.asrc_edma

config MCUX_COMPONENT_driver.asrc
    bool "asrc"
    select MCUX_COMPONENT_driver.common
    depends on MCUX_HAS_COMPONENT_driver.asrc
```

## drivers/dsc_edma3/Kconfig
```kconfig
# Copyright 2026 NXP
#
# SPDX-License-Identifier: BSD-3-Clause

config MCUX_HAS_COMPONENT_driver.dsc_edma3
    bool
    default y if MCUX_HW_IP_DriverType_DSC_EDMA3

config MCUX_COMPONENT_driver.dsc_edma3
    bool "dsc_edma3"
    select MCUX_COMPONENT_driver.common
    select MCUX_COMPONENT_driver.dsc_edma_soc
    depends on MCUX_HAS_COMPONENT_driver.dsc_edma3
```

## drivers/dsc_flash_fmu/Kconfig
```kconfig
# Copyright 2026 NXP
#
# SPDX-License-Identifier: BSD-3-Clause

config MCUX_HAS_COMPONENT_driver.dsc_flash_fmu
    bool
    default y if MCUX_HW_IP_DriverType_DSC_FMU && !(MCUX_HAS_COMPONENT_driver.dsc_flash_romapi)

config MCUX_COMPONENT_driver.dsc_flash_fmu
    bool "dsc_flash_fmu"
    select MCUX_COMPONENT_driver.common
    depends on MCUX_HAS_COMPONENT_driver.dsc_flash_fmu

if MCUX_COMPONENT_driver.dsc_flash_fmu
    config FLASH_COMMAND_COMPLETE_TIMEOUT
        int "Max loops to wait for flash command operations (0 means wait forever)"
        default 0
        help
          This parameter defines how many loops to check completion before return timeout.
          If defined as 0, driver will wait forever until completion.

    config FLASH_WRITE_ENABLE_TIMEOUT
        int "Max loops to wait for flash program-erase write enable (0 means wait forever)"
        default 0
        help
          This parameter defines how many loops to check completion before return timeout.
          If defined as 0, driver will wait forever until completion.

    config FLASH_PROGRAM_ERASE_READY_TIMEOUT
        int "Max loops to wait for flash program-erase ready (0 means wait forever)"
        default 0
        help
          This parameter defines how many loops to check completion before return timeout.
          If defined as 0, driver will wait forever until completion.
endif
```

## drivers/dsc_freqme/Kconfig
```kconfig
# Copyright 2026 NXP
#
# SPDX-License-Identifier: BSD-3-Clause

config MCUX_HAS_COMPONENT_driver.dsc_freqme
    bool
    default y if MCUX_HW_IP_DriverType_DSC_FREQME

config MCUX_COMPONENT_driver.dsc_freqme
    bool "dsc_freqme"
    select MCUX_COMPONENT_driver.common
    depends on MCUX_HAS_COMPONENT_driver.dsc_freqme
```

## drivers/dsc_inputmux/Kconfig
```kconfig
# Copyright 2026 NXP
#
# SPDX-License-Identifier: BSD-3-Clause

config MCUX_HAS_COMPONENT_driver.dsc_inputmux
    bool
    default y if MCUX_HW_IP_DriverType_DSC_INPUTMUX

config MCUX_COMPONENT_driver.dsc_inputmux
    bool "dsc_inputmux"
    select MCUX_COMPONENT_driver.common
    select MCUX_COMPONENT_driver.inputmux_connections
    depends on MCUX_HAS_COMPONENT_driver.dsc_inputmux
```

## drivers/dsc_lpspi/Kconfig
```kconfig
# Copyright 2026 NXP
#
# SPDX-License-Identifier: BSD-3-Clause

config MCUX_HAS_COMPONENT_driver.dsc_lpspi
    bool
    default y if MCUX_HW_IP_DriverType_DSC_LPSPI

config MCUX_COMPONENT_driver.dsc_lpspi
    bool "lpspi"
    select MCUX_COMPONENT_driver.common
    depends on MCUX_HAS_COMPONENT_driver.dsc_lpspi

if MCUX_COMPONENT_driver.dsc_lpspi
    config SPI_RETRY_TIMES
        int "Max loops to wait for operation complete (0 means wait forever)"
        default 0
        help
          This parameter defines how many loops to check completion before return timeout.
          If defined as 0, driver will wait forever until completion.
endif
```

## drivers/dsc_mau/Kconfig
```kconfig
# Copyright 2026 NXP
#
# SPDX-License-Identifier: BSD-3-Clause

config MCUX_HAS_COMPONENT_driver.dsc_mau
    bool
    default y if MCUX_HW_IP_DriverType_DSC_MAU

config MCUX_COMPONENT_driver.dsc_mau
    bool "dsc_mau"
    select MCUX_COMPONENT_driver.common
    depends on MCUX_HAS_COMPONENT_driver.dsc_mau
```

## drivers/dual_adc/Kconfig
```kconfig
# Copyright 2026 NXP
#
# SPDX-License-Identifier: BSD-3-Clause

config MCUX_HAS_COMPONENT_driver.dual_adc
    bool
    default y if MCUX_HW_IP_DriverType_DADC

config MCUX_COMPONENT_driver.dual_adc
    bool "dual_adc"
    select MCUX_COMPONENT_driver.common
    depends on MCUX_HAS_COMPONENT_driver.dual_adc

if MCUX_COMPONENT_driver.dual_adc
    config DUALADC_RESET_TIMEOUT
        int "NOP loop count to hold CTRL[RSTA]/CTRL[RSTB] asserted during software reset"
        default 20
        help
            CTRL[RSTA] and CTRL[RSTB] are NOT self-clearing. The logic high level must
            be sustained for more than 2 ADC functional clock cycles before the reset
            takes effect; the bits are then cleared explicitly by software.

            This value controls how many __NOP() iterations DUALADC_Init executes
            between asserting and releasing the reset bits, providing a portable hold
            time that adapts to different CPU and ADC clock frequency combinations.

            The required count scales with the CPU-to-ADC clock frequency ratio:
              min_count = ceil(2 * f_CPU / f_ADC)
            The default of 20 covers ratios up to 10 (e.g., 150 MHz CPU with a
            16 MHz ADC clock). Increase this value when the CPU clock is much faster
            than the ADC functional clock (i.e., when f_CPU/f_ADC is large) to
            ensure the minimum 2 ADC clock cycle hold time is always met.

    config DUALADC_CALIBRATION_TIMEOUT
        int "Max loops to wait for each DualADC calibration step to complete (0 means wait forever)"
        default 0
        help
            Maximum number of loop iterations for each polling step inside DUALADC_DoCalibration:
            offset calibration (STAT0[CAL_RDY]), high-speed calibration (STAT0[CAL_RDY]),
            gain calibration hardware completion (GCC[n][RDY]), and final CAL_RDY confirmation.
            If set to 0, each step waits indefinitely until completion.
endif
```

## drivers/edma_unified/Kconfig
```kconfig
# Copyright 2024 NXP
#
# SPDX-License-Identifier: BSD-3-Clause

config MCUX_HAS_COMPONENT_driver.edma_unified
    bool
    default y if MCUX_HW_IP_DriverType_EDMA3 || MCUX_HW_IP_DriverType_EDMA4 || MCUX_HW_IP_DriverType_EDMA5

config MCUX_COMPONENT_driver.edma_unified
    bool "edma_unified"
    depends on MCUX_HAS_COMPONENT_driver.edma_unified
    select MCUX_COMPONENT_driver.edma_soc
```

## drivers/flash_k4/Kconfig
```kconfig
# Copyright 2024-2026 NXP
#
# SPDX-License-Identifier: BSD-3-Clause

config MCUX_HAS_COMPONENT_driver.flash_k4
    bool
    default y if MCUX_HW_IP_DriverType_FLASH_K4

config MCUX_COMPONENT_driver.flash_k4.EXPLICITLY_ALLOW_FOR_FMU_IP
    bool "Enable flash_k4 driver for MCX series with FMU IP"
    default n
    depends on MCUX_HW_IP_DriverType_FMU && MCUX_HW_SOC_SERIES_MCX
    help
        flash_k4 driver is also compatible with FMU IP used on MCX A/N devices
        however its integration into SDK is currently problematic due to API
        collision with ROM based FLASH driver. This option is used to enable the
        use of flash_k4 driver and prevent its automatic enablement based on IP
        compatibility.

config MCUX_COMPONENT_driver.flash_k4
    bool "flash_k4"
    select MCUX_COMPONENT_driver.common
    depends on MCUX_HAS_COMPONENT_driver.flash_k4 || MCUX_COMPONENT_driver.flash_k4.EXPLICITLY_ALLOW_FOR_FMU_IP

if MCUX_COMPONENT_driver.flash_k4
    config FLASH_COMMAND_COMPLETE_TIMEOUT
        int "Max loops to wait for flash command operations (0 means wait forever)"
        default 0
        help
          This parameter defines how many loops to check completion before return timeout.
          If defined as 0, driver will wait forever until completion.

    config FLASH_WRITE_ENABLE_TIMEOUT
        int "Max loops to wait for flash program-erase write enable (0 means wait forever)"
        default 0
        help
          This parameter defines how many loops to check completion before return timeout.
          If defined as 0, driver will wait forever until completion.

    config FLASH_PROGRAM_ERASE_READY_TIMEOUT
        int "Max loops to wait for flash program-erase ready (0 means wait forever)"
        default 0
        help
          This parameter defines how many loops to check completion before return timeout.
          If defined as 0, driver will wait forever until completion.
endif


config FLASH_K4_ASYNC_MODE
    bool "Enable Flash K4 Asynchronous Mode (EXPERIMENTAL)"
    default n
    depends on MCUX_COMPONENT_driver.flash_k4
    help
      Queues Write and Erase operations for deferred execution during idle time
      instead of blocking synchronously. Useful in dual-core single-image scenarios
      to prevent flash operations from blocking time-critical tasks (e.g., radio).
      
      Benefits: Reduced blocking, improved real-time responsiveness
      Drawbacks: Increased RAM usage, delayed writes, asynchronous error handling,
                 requires periodic FLASH_Process() calls from idle task

      This feature is EXPERIMENTAL.
if FLASH_K4_ASYNC_MODE

config FLASH_K4_ASYNC_QUEUE_SIZE
    int "Maximum number of pending flash operations in the queue"
    default 64
    help
      Defines the maximum number of flash operations that can be
      queued for asynchronous execution.

config FLASH_K4_ASYNC_TOTAL_BUFFER_SIZE
    int "Total circular buffer size for write data"
    default 1024
    help
      Total size in bytes of the circular buffer used to store
      write data for pending program operations.

config FLASH_K4_WRITE_MIN_IDLE_TIME_US
    int "Minimum idle time for write operations (microseconds)"
    default 1000
    help
      Minimum LL idle duration required before executing a write operation.

config FLASH_K4_ERASE_MIN_IDLE_TIME_US
    int "Minimum idle time for erase operations (microseconds)"
    default 5000
    help
      Minimum LL idle duration required before executing an erase operation.

config FLASH_K4_ASYNC_MERGE_CONTIGUOUS_WRITES
    bool "Enable merging of contiguous write operations"
    default n
    help
      When enabled, contiguous write operations are merged into a single
      operation to improve efficiency.

config FLASH_K4_ASYNC_MAX_OPS_PER_PROCESS
    int "Maximum operations per FLASH_Process() call"
    default 4
    help
      Limits the number of operations processed in a single FLASH_Process()
      call to avoid blocking the idle task for too long.

config FLASH_K4_ASYNC_ENABLE_STATS
    bool "Enable async operation statistics"
    default n
    help
      Enable statistics tracking for debugging and monitoring async
      flash operations.

menu "Flash Operation Timing Estimates"

config FLASH_K4_SECTOR_ERASE_TIME_US
    int "Sector erase time estimate (microseconds)"
    default 5000

config FLASH_K4_PHRASE_PROG_TIME_US
    int "Phrase program time estimate (microseconds)"
    default 50

config FLASH_K4_PAGE_PROG_TIME_US
    int "Page program time estimate (microseconds)"
    default 200

config FLASH_K4_DEFAULT_OP_TIME_US
    int "Default operation time estimate (microseconds)"
    default 100

endmenu # Flash Operation Timing Estimates

endif # FLASH_K4_ASYNC_MODE
```

## drivers/flexio/i2s/Kconfig
```kconfig
# Copyright 2024 NXP
#
# SPDX-License-Identifier: BSD-3-Clause

config MCUX_HAS_COMPONENT_driver.flexio_i2s_dma
    bool
    default y if MCUX_HAS_COMPONENT_driver.flexio && MCUX_HAS_COMPONENT_driver.dma

config MCUX_HAS_COMPONENT_driver.flexio_i2s_edma
    bool
    default y if MCUX_HAS_COMPONENT_driver.flexio && (MCUX_HAS_COMPONENT_driver.edma || MCUX_HAS_COMPONENT_driver.edma_unified)

config MCUX_COMPONENT_driver.flexio_i2s_dma
    bool "flexio_i2s_dma"
    select MCUX_COMPONENT_driver.flexio_i2s
    select MCUX_COMPONENT_driver.dma
    depends on MCUX_HAS_COMPONENT_driver.flexio_i2s_dma

config MCUX_COMPONENT_driver.flexio_i2s_edma
    bool "flexio_i2s_edma"
    select MCUX_COMPONENT_driver.flexio_i2s
    select MCUX_COMPONENT_driver.edma if MCUX_HAS_COMPONENT_driver.edma
    select MCUX_COMPONENT_driver.edma_unified if MCUX_HAS_COMPONENT_driver.edma_unified
    depends on MCUX_HAS_COMPONENT_driver.flexio_i2s_edma

config MCUX_COMPONENT_driver.flexio_i2s
    bool "flexio_i2s"
    select MCUX_COMPONENT_driver.flexio
    depends on MCUX_HAS_COMPONENT_driver.flexio
```

## drivers/flexpwm/Kconfig
```kconfig
# Copyright 2026 NXP
#
# SPDX-License-Identifier: BSD-3-Clause

config MCUX_HAS_COMPONENT_driver.flexpwm
    bool
    default y if MCUX_HW_IP_DriverType_PWM

config MCUX_COMPONENT_driver.flexpwm
    bool "flexpwm"
    select MCUX_COMPONENT_driver.common
    depends on MCUX_HAS_COMPONENT_driver.flexpwm
```

## drivers/mipi_csi2rx_rambus/Kconfig
```kconfig
# Copyright 2026 NXP
# SPDX-License-Identifier: BSD-3-Clause

config MCUX_HAS_COMPONENT_driver.mipi_csi2rx_rambus
    bool
    default y if MCUX_HW_IP_DriverType_MIPI_CSI2RX_RAMBUS

config MCUX_COMPONENT_driver.mipi_csi2rx_rambus
    bool "Use driver mipi_csi2rx_1"
    select MCUX_COMPONENT_driver.common
    depends on MCUX_HAS_COMPONENT_driver.mipi_csi2rx_rambus
```

## drivers/opamp_1/Kconfig
```kconfig
# Copyright 2026 NXP
#
# SPDX-License-Identifier: BSD-3-Clause

config MCUX_HAS_COMPONENT_driver.opamp_1
    bool
    default y if MCUX_HW_IP_DriverType_OPAMP_1

config MCUX_COMPONENT_driver.opamp_1
    bool "opamp"
    select MCUX_COMPONENT_driver.common
    depends on MCUX_HAS_COMPONENT_driver.opamp_1
```

## drivers/powercon/Kconfig
```kconfig
# Copyright 2025 NXP
#
# SPDX-License-Identifier: BSD-3-Clause

config MCUX_HAS_COMPONENT_driver.powercon
    bool
    default y if MCUX_HW_IP_DriverType_POWERCON

config MCUX_COMPONENT_driver.powercon
    bool "powercon"
    select MCUX_COMPONENT_driver.common
    depends on MCUX_HAS_COMPONENT_driver.powercon
```
