## cmake/extension/flash/Kconfig
```kconfig
# Copyright 2026 NXP
#
# SPDX-License-Identifier: BSD-3-Clause

menu "Build output"

config MCUX_BUILD_OUTPUT_HEX
    bool "Build an Intel HEX file from the application"
    default y
    help
      Build an Intel HEX (.hex) output file from the application ELF as a
      POST_BUILD step. The .hex file is consumed by west flash and most NXP
      production programming tools (LinkServer, blhost, MSD drag-and-drop).

config MCUX_BUILD_OUTPUT_BIN
    bool "Build a raw binary file from the application"
    help
      Build a raw binary (.bin) output file from the application ELF as a
      POST_BUILD step. Useful for bootloaders or tools that require a flat
      binary image. Note: a base flash address is required at load time.

endmenu
```

## drivers/cache/llc/Kconfig
```kconfig
# Copyright 2024 NXP
#
# SPDX-License-Identifier: BSD-3-Clause

config MCUX_HAS_COMPONENT_driver.cache_llc
    bool
    default y if MCUX_HW_IP_DriverType_LLC

config MCUX_COMPONENT_driver.cache_llc
    bool "cache_llc"
    select MCUX_COMPONENT_driver.common
    depends on MCUX_HAS_COMPONENT_driver.cache_llc

if MCUX_COMPONENT_driver.cache_llc

    config LLC_MAINTENANCE_TIMEOUT
        int "LLC maintenance operation timeout, in poll iterations (0 = derive)"
        default 0
        help
          How long a cache maintenance operation may take before the driver
          stops waiting and reports kStatus_Timeout, counted in poll-loop
          iterations.

          Leave this at 0 unless you have a reason not to. The driver then
          derives the budget from the cache geometry, which is what bounds the
          work an operation has to do, with margin over the measured worst case
          of every cache entry resident and dirty. Kconfig cannot see the
          device's way and set counts, so it cannot express that derivation
          here.

          A non-zero value replaces the derived budget verbatim. Setting it too
          low makes a maintenance operation that is progressing normally return
          kStatus_Timeout, so only raise it above the derived value - for
          instance if the memory behind the cache is slower than the devices
          this driver was characterized on.

endif
```

## drivers/dsc_i3c/Kconfig
```kconfig
# Copyright 2026 NXP
#
# SPDX-License-Identifier: BSD-3-Clause

config MCUX_HAS_COMPONENT_driver.dsc_i3c
    bool
    default y if MCUX_HW_IP_DriverType_DSC_I3C

config MCUX_COMPONENT_driver.dsc_i3c
    bool "i3c"
    select MCUX_COMPONENT_driver.common
    depends on MCUX_HAS_COMPONENT_driver.dsc_i3c

if MCUX_COMPONENT_driver.dsc_i3c
    config I3C_RETRY_TIMES
        int "Max loops to wait for I3C operation status complete (0 means wait forever)"
        default 0
        help
            This is the maximum number of loops to wait for I3C operation status complete.
            If set to 0, it will wait indefinitely.
endif
```

## drivers/dsc_spc/Kconfig
```kconfig
# Copyright 2026 NXP
#
# SPDX-License-Identifier: BSD-3-Clause

config MCUX_HAS_COMPONENT_driver.dsc_spc
    bool
    default y if MCUX_HW_IP_DriverType_DSC_SPC

config MCUX_COMPONENT_driver.dsc_spc
    bool "dsc_spc"
    select MCUX_COMPONENT_driver.common
    depends on MCUX_HAS_COMPONENT_driver.dsc_spc
```

## drivers/dsc_tro/Kconfig
```kconfig
# Copyright 2026 NXP
#
# SPDX-License-Identifier: BSD-3-Clause

config MCUX_HAS_COMPONENT_driver.dsc_tro
    bool
    default y if MCUX_HW_IP_DriverType_DSC_TRO

config MCUX_COMPONENT_driver.dsc_tro
    bool "dsc_tro"
    select MCUX_COMPONENT_driver.common
    depends on MCUX_HAS_COMPONENT_driver.dsc_tro

if MCUX_COMPONENT_driver.dsc_tro

    config TRO_CONFIG_VLD_TIMEOUT
        int "Max loops to wait for TRO configuration valid (0 means wait forever)"
        default 0
        help
          CSR[TRO_CONFIG_VLD] asserts after CSR[TROEN] is set and gates the DLY_CFG
          and DIV_CFG writes that follow, so the driver waits for it during TRO_Init.
          This parameter defines how many loops to check completion before return timeout.
          If defined as 0, driver will wait forever until completion.

    config TRO_DLY_DONE_TIMEOUT
        int "Max loops to wait for TRO delay line shift transfer complete (0 means wait forever)"
        default 0
        help
          DLY_CFG[TRO_DLY_DONE] reports that the previous delay line shift transfer
          completed, so the driver waits for it before writing new delay line lengths.
          This parameter defines how many loops to check completion before return timeout.
          If defined as 0, driver will wait forever until completion.

    config TRO_DIV_DONE_TIMEOUT
        int "Max loops to wait for TRO divider shift transfer complete (0 means wait forever)"
        default 0
        help
          DIV_CFG[TRO_DIV_DONE] reports that the previous divider shift transfer
          completed, so the driver waits for it before writing a new divider value.
          This parameter defines how many loops to check completion before return timeout.
          If defined as 0, driver will wait forever until completion.

endif
```

## drivers/enet_qos/Kconfig
```kconfig
# Copyright 2024 NXP
#
# SPDX-License-Identifier: BSD-3-Clause

config MCUX_HAS_COMPONENT_driver.enet_qos
    bool
    default y if MCUX_HW_IP_DriverType_ENET_QOS
    default y if MCUX_HW_IP_DriverType_EMAC

config MCUX_COMPONENT_driver.enet_qos
    bool "enet_qos"
    select MCUX_COMPONENT_driver.common
    depends on MCUX_HAS_COMPONENT_driver.enet_qos

if MCUX_COMPONENT_driver.enet_qos
    config ENET_QOS_SETMII_DELAY
        int "NOP loop count to let a MAC config write settle in ENET_QOS_SetMII"
        default 1000
        help
            Number of __NOP() iterations ENET_QOS_SetMII waits after a MAC_CONFIGURATION
            write before writing the same register again. Increase it when the CPU clock
            is much faster than the MAC transmit/receive clock.
endif
```

## drivers/gpio/Kconfig
```kconfig
# Copyright 2024-2026 NXP
#
# SPDX-License-Identifier: BSD-3-Clause

config MCUX_HAS_COMPONENT_driver.gpio
    bool
    default y if MCUX_HW_IP_DriverType_GPIO

config MCUX_COMPONENT_driver.gpio
    bool "gpio"
    select MCUX_COMPONENT_driver.common
    depends on MCUX_HAS_COMPONENT_driver.gpio

if MCUX_COMPONENT_driver.gpio
    config GPIO_PIN_CALLBACK_COUNT
        int "Number of per-pin interrupt callback entries per GPIO handle"
        default 4
        help
          Number of callback entries in each gpio_handle_t. Each entry binds a
          pin bitmask to one callback, so this is the number of distinct
          consumers that can share a single GPIO controller (not the number of
          pins). Larger values allow more independent consumers on one
          controller at the cost of a bigger handle.
endif
```

## drivers/lpc_enet/Kconfig
```kconfig
# Copyright 2024 NXP
#
# SPDX-License-Identifier: BSD-3-Clause

config MCUX_HAS_COMPONENT_driver.lpc_enet
    bool
    default y if MCUX_HW_IP_DriverType_LPC_ENET

config MCUX_COMPONENT_driver.lpc_enet
    bool "lpc_enet"
    select MCUX_COMPONENT_driver.common
    depends on MCUX_HAS_COMPONENT_driver.lpc_enet

if MCUX_COMPONENT_driver.lpc_enet
    config ENET_SETMII_DELAY
        int "NOP loop count to let a MAC config write settle in ENET_SetMII"
        default 1000
        help
            Number of __NOP() iterations ENET_SetMII waits after a MAC_CONFIG write
            before writing the same register again. Increase it when the CPU clock is
            much faster than the MAC transmit/receive clock.
endif
```

## drivers/mcx_enet/Kconfig
```kconfig
# Copyright 2024 NXP
#
# SPDX-License-Identifier: BSD-3-Clause

config MCUX_HAS_COMPONENT_driver.mcx_enet
    bool
    default y if MCUX_HW_IP_DriverType_MCX_ENET

config MCUX_COMPONENT_driver.mcx_enet
    bool "mcx_enet"
    select MCUX_COMPONENT_driver.common
    depends on MCUX_HAS_COMPONENT_driver.mcx_enet

if MCUX_COMPONENT_driver.mcx_enet
    config ENET_SETMII_DELAY
        int "NOP loop count to let a MAC config write settle in ENET_SetMII"
        default 1000
        help
            Number of __NOP() iterations ENET_SetMII waits after a MAC_CONFIGURATION
            write before writing the same register again. Increase it when the CPU clock
            is much faster than the MAC transmit/receive clock.
endif
```

## drivers/qspi/Kconfig
```kconfig
# Copyright 2024-2025 NXP
#
# SPDX-License-Identifier: BSD-3-Clause

config MCUX_DEPENDENCY_COMPONENT_driver.qspi_mcxe247
    bool
    default y if MCUX_HW_DEVICE_ID_MCXE247

config MCUX_COMPONENT_driver.qspi_mcxe247
    bool
    default y if MCUX_DEPENDENCY_COMPONENT_driver.qspi_mcxe247 && MCUX_COMPONENT_driver.qspi
    depends on MCUX_DEPENDENCY_COMPONENT_driver.qspi_mcxe247

config MCUX_DEPENDENCY_COMPONENT_driver.qspi_mcxe31b
    bool
    default y if MCUX_HW_DEVICE_ID_MCXE31B

config MCUX_COMPONENT_driver.qspi_mcxe31b
    bool
    default y if MCUX_DEPENDENCY_COMPONENT_driver.qspi_mcxe31b && MCUX_COMPONENT_driver.qspi
    depends on MCUX_DEPENDENCY_COMPONENT_driver.qspi_mcxe31b

config MCUX_DEPENDENCY_COMPONENT_driver.qspi_mcxe32b
    bool
    default y if MCUX_HW_DEVICE_ID_MCXE32B

config MCUX_COMPONENT_driver.qspi_mcxe32b
    bool
    default y if MCUX_DEPENDENCY_COMPONENT_driver.qspi_mcxe32b && MCUX_COMPONENT_driver.qspi
    depends on MCUX_DEPENDENCY_COMPONENT_driver.qspi_mcxe32b

config MCUX_DEPENDENCY_COMPONENT_driver.qspi_mcxe327
    bool
    default y if MCUX_HW_DEVICE_ID_MCXE327

config MCUX_COMPONENT_driver.qspi_mcxe327
    bool
    default y if MCUX_DEPENDENCY_COMPONENT_driver.qspi_mcxe327 && MCUX_COMPONENT_driver.qspi
    depends on MCUX_DEPENDENCY_COMPONENT_driver.qspi_mcxe327

config MCUX_HAS_COMPONENT_driver.qspi_edma
    bool
    default y if MCUX_HAS_COMPONENT_driver.qspi && (MCUX_HAS_COMPONENT_driver.edma || MCUX_HAS_COMPONENT_driver.edma_unified)

config MCUX_DEPENDENCY_COMPONENT_driver.qspi_imx
    bool
    default y if MCUX_HW_DEVICE_MCIMX7U5 || MCUX_HW_DEVICE_MCIMX7U3 ||\
                 MCUX_HW_DEVICE_MIMX8MQ6 || MCUX_HW_DEVICE_MIMX8MQ5 ||\
                 MCUX_HW_DEVICE_MIMX8MQ7 || MCUX_HW_DEVICE_MIMX8MD6 ||\
                 MCUX_HW_DEVICE_MIMX8MD7

config MCUX_HAS_COMPONENT_driver.qspi
    bool
    default y if MCUX_HW_IP_DriverType_QUADSPI
    default y if MCUX_DEPENDENCY_COMPONENT_driver.qspi_imx

config MCUX_COMPONENT_driver.qspi_edma
    bool "qspi_edma"
    select MCUX_COMPONENT_driver.qspi
    select MCUX_COMPONENT_driver.edma if MCUX_HAS_COMPONENT_driver.edma
    select MCUX_COMPONENT_driver.edma_unified if MCUX_HAS_COMPONENT_driver.edma_unified
    depends on MCUX_HAS_COMPONENT_driver.qspi_edma

config MCUX_COMPONENT_driver.qspi
    bool "qspi"
    select MCUX_COMPONENT_driver.common
    depends on MCUX_HAS_COMPONENT_driver.qspi
```

## drivers/rt2k_pmu/Kconfig
```kconfig
# Copyright 2025 NXP
#
# SPDX-License-Identifier: BSD-3-Clause

config MCUX_HAS_COMPONENT_driver.rt2k_pmu
    bool
    default y if MCUX_HW_IP_DriverType_RT2K_PMU

config MCUX_COMPONENT_driver.rt2k_pmu
    bool "rt2k_pmu"
    select MCUX_COMPONENT_driver.common
    depends on MCUX_HAS_COMPONENT_driver.rt2k_pmu

if MCUX_COMPONENT_driver.rt2k_pmu
    config PMU_BB_UPDATE_TIMEOUT
    int "Max loops to wait for PMU body bias update done."
    default 0
    help
        The PMU_BB_CFG_DONE bit field will be set once new
        settings of body bias completed.
        If defined as 0, the driver will wait until completion.

    config PMU_DRIVER_UPDATE_TRIM_VALUE
    bool "Let PMU_ConfigBodyBias write the N-well/P-well trim fields"
    default n
    help
        Parts whose P-Well/N-Well body-bias fuse is not yet trimmed rely on ROM to
        apply the trim directly to PMU_BODYBIAS_CONFIG_REG; PMU_ConfigBodyBias() must
        not overwrite it. With this option disabled (default), PMU_ConfigBodyBias()
        does a read-modify-write that leaves the NWELL_VOL/PWELL_VOL bitfields alone.
        Enable this only once the fuse is trimmed and a caller-supplied trim value is
        meant to be written to hardware.

endif
```

## drivers/sctimer/Kconfig
```kconfig
# Copyright 2024 NXP
#
# SPDX-License-Identifier: BSD-3-Clause

config MCUX_HAS_COMPONENT_driver.sctimer
    bool
    default y if MCUX_HW_IP_DriverType_SCTIMER

config MCUX_COMPONENT_driver.sctimer
    bool "sctimer"
    select MCUX_COMPONENT_driver.common
    depends on MCUX_HAS_COMPONENT_driver.sctimer

if MCUX_COMPONENT_driver.sctimer

    config FSL_SCTIMER_PWM_INIT_INACTIVE_OUTPUT
        bool "Start an edge-aligned PWM output at its inactive level"
        default n
        help
          Affects edge-aligned PWM channels set up by SCTIMER_SetupSharedPeriodPwm().
          By default the first PWM period already carries its pulse. Enable this and
          the output stays inactive through the first period instead, so the PWM
          output starts one period late and the pin will not go active before the
          timer is started. A 0% duty cycle stays inactive either way.

endif
```
