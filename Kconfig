## Kconfig
```kconfig
# Copyright 2024 NXP
#
# SPDX-License-Identifier: BSD-3-Clause

mainmenu "MCUXpresso SDK Run Time Configuration"

rsource "Kconfig.mcuxpresso"
```

## Kconfig.mcuxpresso
```kconfig
# Copyright 2024 NXP
#
# SPDX-License-Identifier: BSD-3-Clause

# board
rsource "examples/Kconfig"

# device
rsource "devices/Kconfig"

# Driver config
menu "Driver Configuration"
    rsource "drivers/Kconfig"
    osource "rtos/freertos/freertos-drivers/Kconfig"
endmenu

# Component config
rsource "components/Kconfig"

# middleware config
menu "Middleware"
    osource "middleware/wifi_nxp/Kconfig"
    osource "middleware/mbedtls/Kconfig"
    osource "middleware/usb/Kconfig"
    osource "middleware/fatfs/Kconfig"
    osource "middleware/littlefs/Kconfig"
    osource "middleware/multicore/Kconfig"
    osource "middleware/vglite/vglite_sdk/Kconfig"
    menu "audio_voice"
        osource "middleware/audio_voice/maestro/Kconfig"
        osource "middleware/audio_voice/components/Kconfig"
    endmenu
    osource "middleware/wireless/framework/Kconfig"
    osource "middleware/wireless/framework_private/Kconfig"
    osource "middleware/wireless/XCVR/Kconfig"
    osource "middleware/wireless/genfsk/Kconfig"
    osource "middleware/lwip/Kconfig"
    osource "middleware/soem/Kconfig"
    osource "middleware/wireless/bluetooth/Kconfig"
	osource "middleware/wireless/bluetooth_private/Kconfig"
    osource "middleware/wireless/ble_controller/Kconfig"
    osource "middleware/wireless/wpa_supplicant-rtos/Kconfig"
    osource "middleware/wireless/ieee-802.15.4/Kconfig"
    osource "middleware/wireless/zigbee/Kconfig"
    osource "middleware/mbedtls3x/Kconfig"
    osource "middleware/tfm/tf-m/mcux/Kconfig"
    osource "middleware/mmcau/Kconfig"
    osource "middleware/sdmmc/Kconfig"
    osource "middleware/edgefast_bluetooth/Kconfig"
    osource "middleware/wireless/ethermind/Kconfig"
    osource "middleware/freemaster/Kconfig"
    osource "middleware/llhttp/Kconfig"
    osource "middleware/tinycbor/Kconfig"
    osource "middleware/pkcs11/Kconfig"
    osource "middleware/secure-subsystem/Kconfig"
    osource "middleware/rtcesl/Kconfig"
    osource "middleware/motor_control/Kconfig"
    osource "middleware/cjson/Kconfig"
    osource "middleware/libjpeg/Kconfig"
    osource "middleware/pngdec/Kconfig"
    osource "middleware/openh264/Kconfig"
    osource "middleware/lin_stack/Kconfig"
    osource "examples/lvgl_examples/lvgl_sdk/Kconfig"
    osource "middleware/cadence/Kconfig"
    osource "middleware/mcuboot_opensource/Kconfig"
    osource "middleware/touch/Kconfig"
    osource "middleware/metering/Kconfig"
    osource "middleware/aws_iot/device-defender/Kconfig"
    osource "middleware/aws_iot/device-shadow/Kconfig"
    osource "middleware/aws_iot/jobs/Kconfig"
    osource "middleware/aws_iot/ota/Kconfig"
    osource "middleware/nxp_iot_agent/Kconfig"
    osource "middleware/eiq/Kconfig"
    osource "middleware/openvg/Kconfig"
    osource "middleware/se_hostlib/Kconfig"
    osource "middleware/issdk/Kconfig"
    osource "middleware/emwin/Kconfig"
    osource "middleware/dhara/Kconfig"
endmenu

# RTOS config
menu "RTOS"
menu "FreeRTOS"
    osource "rtos/freertos/freertos-kernel/Kconfig"
    osource "rtos/freertos/backoffalgorithm/Kconfig"
    osource "rtos/freertos/corehttp/Kconfig"
    osource "rtos/freertos/corejson/Kconfig"
    osource "rtos/freertos/coremqtt/Kconfig"
    osource "rtos/freertos/coremqtt-agent/Kconfig"
    osource "rtos/freertos/corepkcs11/Kconfig"
    osource "rtos/freertos/freertos-plus-tcp/Kconfig"
endmenu
endmenu

menu "External Modules"

    osource "$(KCONFIG_BINARY_DIR)/Kconfig.modules"

endmenu
```

## arch/arm/cortexa/Kconfig
```kconfig
# Copyright 2025 NXP
#
# SPDX-License-Identifier: BSD-3-Clause

config CPU_CORTEX_A
    bool
    help
      This option signifies the use of a CPU of the Cortex-A family.

config MCUX_PRJSEG_config.arm.core.ca53
    bool
    select CPU_CORTEX_A
    default y if MCUX_HW_CORE_CA53

config MCUX_PRJSEG_config.arm.core.ca55
    bool
    select CPU_CORTEX_A
    default y if MCUX_HW_CORE_CA55
```

## arch/arm/cortexm/Kconfig
```kconfig
# Copyright 2024 NXP
#
# SPDX-License-Identifier: BSD-3-Clause

config CPU_CORTEX_M
    bool
    help
      This option signifies the use of a CPU of the Cortex-M family.

config MCUX_PRJSEG_config.arm.core.cm4
    bool
    select CPU_CORTEX_M
    default y if MCUX_HW_CORE_CM4

config MCUX_PRJSEG_config.arm.core.cm4f
    bool
    select CPU_CORTEX_M
    default y if MCUX_HW_CORE_CM4F

config MCUX_PRJSEG_config.arm.core.fpu.no_fpu
    bool
    select CPU_CORTEX_M
    default y if MCUX_HW_NO_FPU

config MCUX_PRJSEG_config.arm.core.fpu.fpv4_sp
    bool
    select CPU_CORTEX_M
    default y if MCUX_HW_FPV4_SP

config MCUX_PRJSEG_config.device_core.define
    bool
    select CPU_CORTEX_M
    default y

config MCUX_PRJSEG_config.arm.core.cm7f
    bool
    select CPU_CORTEX_M
    default y if MCUX_HW_CORE_CM7F

config MCUX_PRJSEG_config.arm.core.fpu.fpv5_dp
    bool
    select CPU_CORTEX_M
    default y if MCUX_HW_FPV5_DP

config MCUX_PRJSEG_config.arm.core.fpu.fpv5_sp
    bool
    select CPU_CORTEX_M
    default y if MCUX_HW_FPV5_SP

config MCUX_PRJSEG_config.arm.core.cm33
    bool
    select CPU_CORTEX_M
    default y if MCUX_HW_CORE_CM33 && MCUX_HW_DSP && MCUX_HW_SAU

config MCUX_PRJSEG_config.arm.core.cm33_nodsp_nosau
    bool
    select CPU_CORTEX_M
    default y if MCUX_HW_CORE_CM33 && !MCUX_HW_DSP && !MCUX_HW_SAU

config MCUX_PRJSEG_config.arm.core.cm33_dsp_nosau
    bool
    select CPU_CORTEX_M
    default y if MCUX_HW_CORE_CM33 && MCUX_HW_DSP && !MCUX_HW_SAU

config MCUX_PRJSEG_config.arm.core.cm33_nodsp_sau
    bool
    select CPU_CORTEX_M
    default y if MCUX_HW_CORE_CM33 && !MCUX_HW_DSP && MCUX_HW_SAU

config MCUX_PRJSEG_config.arm.core.cm23
    bool
    select CPU_CORTEX_M
    default y if MCUX_HW_CORE_CM23 && MCUX_HW_SAU

config MCUX_PRJSEG_config.arm.core.cm23_nosau
    bool
    select CPU_CORTEX_M
    default y if MCUX_HW_CORE_CM23 && !MCUX_HW_SAU

config MCUX_PRJSEG_config.arm.core.cm0p
    bool
    select CPU_CORTEX_M
    default y if MCUX_HW_CORE_CM0P

config MCUX_PRJSEG_config.arm.core.cm55
    bool
    select CPU_CORTEX_M
    default y if MCUX_HW_CORE_CM55 && MCUX_HW_DSP && MCUX_HW_SAU

config MCUX_PRJSEG_config.arm.core.cm55_nodsp_nosau
    bool
    select CPU_CORTEX_M
    default y if MCUX_HW_CORE_CM55 && !MCUX_HW_DSP && !MCUX_HW_SAU

config MCUX_PRJSEG_config.arm.core.cm55_dsp_nosau
    bool
    select CPU_CORTEX_M
    default y if MCUX_HW_CORE_CM55 && MCUX_HW_DSP && !MCUX_HW_SAU

config MCUX_PRJSEG_config.arm.core.cm55_nodsp_sau
    bool
    select CPU_CORTEX_M
    default y if MCUX_HW_CORE_CM55 && !MCUX_HW_DSP && MCUX_HW_SAU

config MCUX_PRJSEG_config.arm.core.cm85
    bool
    select CPU_CORTEX_M
    default y if MCUX_HW_CORE_CM85 && MCUX_HW_DSP && MCUX_HW_SAU

config MCUX_PRJSEG_config.arm.core.cm85_nodsp_nosau
    bool
    select CPU_CORTEX_M
    default y if MCUX_HW_CORE_CM85 && !MCUX_HW_DSP && !MCUX_HW_SAU

config MCUX_PRJSEG_config.arm.core.cm85_dsp_nosau
    bool
    select CPU_CORTEX_M
    default y if MCUX_HW_CORE_CM85 && MCUX_HW_DSP && !MCUX_HW_SAU

config MCUX_PRJSEG_config.arm.core.cm85_nodsp_sau
    bool
    select CPU_CORTEX_M
    default y if MCUX_HW_CORE_CM85 && !MCUX_HW_DSP && MCUX_HW_SAU
```

## cmake/extension/sysbuild/Kconfig.v1
```kconfig
# Copyright (c) 2023 Nordic Semiconductor
# Copyright 2025 NXP
#
# SPDX-License-Identifier: Apache-2.0

# Intentionally left empty as sysbuild Kconfig doesn't support hw model v1.

menu "Modules"

comment "Available modules."

source "$(KCONFIG_BINARY_DIR)/Kconfig.sysbuild.modules"

endmenu
```

## devices/Kconfig
```kconfig
menu "Device Configuration"
rsource "../${device_root}/${soc_portfolio}/${soc_series}/${device}/Kconfig"
endmenu
```

## devices/arm/Kconfig.common
```kconfig
rsource "../../arch/arm/configuration/Kconfig"
rsource "../../arch/arm/cortexm/Kconfig"
rsource "../../arch/arm/cortexa/Kconfig"
orsource "../../arch/arm/CMSIS/Kconfig"

menu "Startup components"
    config MCUX_COMPONENT_device.CMSIS
        bool "CMSIS"

    config MCUX_COMPONENT_device.system
        bool "system"
        imply MCUX_COMPONENT_device.CMSIS

    config MCUX_COMPONENT_device.startup
        bool "startup"
        imply MCUX_COMPONENT_device.system

    config MCUX_COMPONENT_device.RTE
        bool "rte"        

    config FLASH_BASE_ADDRESS
        hex "Flash base address"
        default 0x0

    config FLASH_DEFAULT_APP_OFFSET
        hex "Default application offset in flash(DO NOT CHANGE, use load offset instead)"
        default 0x0

    config HAS_FLASH_LOAD_OFFSET
        bool "Application has load offset"
        default y

    if HAS_FLASH_LOAD_OFFSET
        config FLASH_LOAD_OFFSET
            hex "Application load offset from flash base address"
            default FLASH_DEFAULT_APP_OFFSET
    endif
endmenu

config MCUX_PRJSEG_module.device.suite
    bool
    default y
```

## devices/dsp56800/Kconfig.common
```kconfig
rsource "../../arch/dsp56800/configuration/Kconfig"
rsource "../../arch/dsp56800/core/Kconfig"

menu "Startup components"
    config MCUX_COMPONENT_device.CMSIS
        bool "header"

    config MCUX_COMPONENT_device.system
        bool "system"
        imply MCUX_COMPONENT_device.CMSIS

    config MCUX_COMPONENT_device.startup
        bool "startup"
        imply MCUX_COMPONENT_device.system
endmenu

config MCUX_PRJSEG_module.device.suite
    bool
    default y

config MCUX_COMPONENT_device.startup_common
    bool
    default y if MCUX_COMPONENT_device.startup
```

## devices/ezhv/Kconfig.common
```kconfig
# Copyright 2024 NXP
#
# SPDX-License-Identifier: BSD-3-Clause

rsource "../../arch/riscv/configuration/Kconfig"
rsource "../../arch/riscv/core/Kconfig"
rsource "../../arch/riscv/headers/Kconfig"

menu "Startup components"
    config MCUX_COMPONENT_device.CMSIS
        bool "header"

    config MCUX_COMPONENT_device.system
        bool "system"
        imply MCUX_COMPONENT_device.CMSIS

    config MCUX_COMPONENT_device.startup
        bool "startup"
        imply MCUX_COMPONENT_device.system
endmenu

config MCUX_PRJSEG_module.device.suite
    bool
    default y
```

## devices/xtensa/Kconfig.common
```kconfig
# FIXME improved shared arch files
rsource "../../arch/xtensa/configuration/Kconfig"
rsource "../../arch/xtensa/core/Kconfig"

menu "Startup components"
    config MCUX_COMPONENT_device.CMSIS
        bool "header"

    config MCUX_COMPONENT_device.system
        bool "system"
        imply MCUX_COMPONENT_device.CMSIS
endmenu

config MCUX_PRJSEG_module.device.suite
    bool
    default y
```

## drivers/aon_lpadc/Kconfig
```kconfig
# Copyright 2024 NXP
#
# SPDX-License-Identifier: BSD-3-Clause

config MCUX_HAS_COMPONENT_driver.aon_lpadc
    bool
    default y if MCUX_HW_IP_DriverType_AON_LPADC

config MCUX_COMPONENT_driver.aon_lpadc
    bool "aon_lpadc"
    select MCUX_COMPONENT_driver.common
    depends on MCUX_HAS_COMPONENT_driver.aon_lpadc
```

## drivers/audmix/Kconfig
```kconfig
# Copyright 2025 NXP
#
# SPDX-License-Identifier: BSD-3-Clause

config MCUX_HAS_COMPONENT_driver.audmix
    bool
    default y if MCUX_HW_IP_DriverType_AUDMIX

config MCUX_COMPONENT_driver.audmix
    bool "audmix"
    select MCUX_COMPONENT_driver.common
    depends on MCUX_HAS_COMPONENT_driver.audmix
    help
      This is the AUDMIX (Audio Mixer) driver, used for audio signal mixing and attenuation control.
      The AUDMIX peripheral allows mixing of two TDM audio streams with configurable attenuation.
```

## drivers/bctu/Kconfig
```kconfig
# Copyright 2025 NXP
#
# SPDX-License-Identifier: BSD-3-Clause

config MCUX_HAS_COMPONENT_driver.bctu
    bool
    default y if MCUX_HW_IP_DriverType_BCTU

config MCUX_COMPONENT_driver.bctu
    bool "bctu"
    select MCUX_COMPONENT_driver.common
    depends on MCUX_HAS_COMPONENT_driver.bctu
```

## drivers/biss/Kconfig
```kconfig
# SPDX-License-Identifier: BSD-3-Clause

config MCUX_HAS_COMPONENT_driver.biss
    bool
    default y if MCUX_HW_IP_DriverType_BISS

config MCUX_COMPONENT_driver.biss
    bool "Use driver BiSS"
    select MCUX_COMPONENT_driver.common
    depends on MCUX_HAS_COMPONENT_driver.biss
```

## drivers/cache/armv8-a/Kconfig
```kconfig
# Copyright 2025 NXP
#
# SPDX-License-Identifier: BSD-3-Clause

config MCUX_COMPONENT_driver.cache_armv8_a
    bool "cache driver for AArch64"
    default y if CPU_CORTEX_A
```

## drivers/cache/llc/Kconfig
```kconfig
# Copyright 2024 NXP
#
# SPDX-License-Identifier: BSD-3-Clause

config MCUX_HAS_COMPONENT_driver.cache_llc
    bool
    default y if MCUX_HW_IP_DriverType_LLC

config MCUX_COMPONENT_driver.cache_llc
    bool "cache_llc"
    select MCUX_COMPONENT_driver.common
    depends on MCUX_HAS_COMPONENT_driver.cache_llc

if MCUX_COMPONENT_driver.cache_llc

    config LLC_MAINTENANCE_TIMEOUT
        int "LLC maintenance operation timeout"
        default 1000
        help
          Timeout value for LLC maintenance operations.

endif
```

## drivers/ce/Kconfig
```kconfig
# Copyright 2024-2025 NXP
#
# SPDX-License-Identifier: BSD-3-Clause

config MCUX_HAS_COMPONENT_driver.ce
    bool
    default y if MCUX_HW_IP_DriverType_CE

config MCUX_COMPONENT_driver.ce
    bool "Compute Engine"
    select MCUX_COMPONENT_driver.common
    depends on MCUX_HAS_COMPONENT_driver.ce

if MCUX_COMPONENT_driver.ce
    config CE_COMPUTE_TIMEOUT
        int "Max loops to wait for CE computation (0 means wait forever)"
        default 0
        help
          This parameter defines how many loops to check completion before return timeout.
          If defined as 0, driver will wait forever until completion.
endif
```

## drivers/cmc/Kconfig
```kconfig
# Copyright 2024 NXP
#
# SPDX-License-Identifier: BSD-3-Clause

config MCUX_HAS_COMPONENT_driver.cmc
    bool
    default y if MCUX_HW_IP_DriverType_CMC

config MCUX_COMPONENT_driver.cmc
    bool "cmc"
    select MCUX_COMPONENT_driver.common
    depends on MCUX_HAS_COMPONENT_driver.cmc

if MCUX_COMPONENT_driver.cmc

    config CMC_SRAM_BUSY_TIMEOUT
        int "Max loops to wait for CMC SRAM operation complete (0 means wait forever)"
        default 0
        help
          When configuring the SRAM, driver will wait for the completion of new settings.
          This parameter defines how many loops to check completion before return timeout.
          If defined as 0, driver will wait forever until completion.

endif
```

## drivers/cmu_fc/Kconfig
```kconfig
# Copyright 2025 NXP
#
# SPDX-License-Identifier: BSD-3-Clause
config MCUX_HAS_COMPONENT_driver.cmu_fc
    bool
    default y if MCUX_HW_IP_DriverType_CMU_FC

config MCUX_COMPONENT_driver.cmu_fc
    bool "cmu_fc"
    select MCUX_COMPONENT_driver.common
    depends on MCUX_HAS_COMPONENT_driver.cmu_fc
    help
      This driver provides APIs to configure the Clock Monitoring Unit Frequency Check module.
```

## drivers/cmu_fm/Kconfig
```kconfig
# Copyright 2025 NXP
#
# SPDX-License-Identifier: BSD-3-Clause
config MCUX_HAS_COMPONENT_driver.cmu_fm
    bool
    default y if MCUX_HW_IP_DriverType_CMU_FM

config MCUX_COMPONENT_driver.cmu_fm
    bool "cmu_fm"
    select MCUX_COMPONENT_driver.common
    depends on MCUX_HAS_COMPONENT_driver.cmu_fm
    help
      This driver provides APIs to configure the Clock Monitoring Unit Frequency Meter module.
```

## drivers/dcif_1/Kconfig
```kconfig
# Copyright 2025 NXP
#
# SPDX-License-Identifier: BSD-3-Clause

config MCUX_HAS_COMPONENT_driver.dcif_1
    bool
    default y if MCUX_HW_IP_DriverType_DCIF_1

config MCUX_COMPONENT_driver.dcif_1
    bool "dcif_1"
    select MCUX_COMPONENT_driver.common
    depends on MCUX_HAS_COMPONENT_driver.dcif_1

if MCUX_COMPONENT_driver.dcif_1

    config DCIF_DBI_CMD_TIMEOUT
        int "Max loops to wait for DBI command complete (0 means wait forever)"
        default 0

endif
```
