## drivers/dma3/Kconfig
```kconfig
# Copyright 2024 NXP
#
# SPDX-License-Identifier: BSD-3-Clause

config MCUX_HAS_COMPONENT_driver.ad_dma3
    bool
    default y if MCUX_HW_IP_DriverType_AD_DMA3

config MCUX_HAS_COMPONENT_driver.dma3
    bool
    default y if MCUX_HW_IP_DriverType_DMA3

config MCUX_COMPONENT_driver.ad_dma3
    bool "Use driver ad_dma3"
    depends on MCUX_HAS_COMPONENT_driver.ad_dma3

config MCUX_COMPONENT_driver.dma3
    bool "Use driver dma3"
    depends on MCUX_HAS_COMPONENT_driver.dma3
```

## drivers/dsc_port/Kconfig
```kconfig
# Copyright 2025 NXP
#
# SPDX-License-Identifier: BSD-3-Clause

config MCUX_HAS_COMPONENT_driver.dsc_port
    bool
    default y if MCUX_HW_IP_DriverType_DSC_PORT

config MCUX_COMPONENT_driver.dsc_port
    bool "port"
    select MCUX_COMPONENT_driver.common
    depends on MCUX_HAS_COMPONENT_driver.dsc_port
```

## drivers/dsc_rgpio/Kconfig
```kconfig
# Copyright 2024 NXP
#
# SPDX-License-Identifier: BSD-3-Clause

config MCUX_HAS_COMPONENT_driver.dsc_rgpio
    bool
    default y if MCUX_HW_IP_DriverType_DSC_RGPIO

config MCUX_COMPONENT_driver.dsc_rgpio
    bool "dsc_rgpio"
    select MCUX_COMPONENT_driver.common
    depends on MCUX_HAS_COMPONENT_driver.dsc_rgpio
```

## drivers/dsc_wrap/Kconfig
```kconfig
# Copyright 2024 NXP
#
# SPDX-License-Identifier: BSD-3-Clause

config MCUX_HAS_COMPONENT_driver.dsc_driver_wrap
    bool
    default y if MCUX_COMPONENT_driver.platformlib && MCUX_HW_SOC_SERIES_DSC

config MCUX_COMPONENT_driver.dsc_driver_wrap
    bool "dsc_driver_wrap"
    select MCUX_COMPONENT_driver.common
    depends on MCUX_HAS_COMPONENT_driver.dsc_driver_wrap
```
